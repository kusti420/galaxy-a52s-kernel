// SPDX-License-Identifier: GPL-2.0-only
/*
 * Samsung "PBA booting" dummy panel (main board without a panel attached).
 * GENERATED by tools/gen-dts.py from downstream-dt/a52sxq-r02.dts (the merged tree the
 * phone boots: yupik.dtb + overlay a52sxq_kor_single_w00_r02, used by hardware revisions
 * 2 and later, so 3 and 4 too). Values are byte-for-byte the phone's; only phandles were
 * turned into labels. Do not edit by hand; edit the generator.
 */

&mdss_mdp {
	ss_dsi_panel_PBA_BOOTING_FHD: ss_dsi_panel_PBA_BOOTING_FHD {
		qcom,dsi-select-clocks = "mux_byte_clk0", "mux_pixel_clk0";
		qcom,platform-reset-gpio = <&tlmm 0x2c 0x0>;
		qcom,dsi-phy-num = <0x00>;
		qcom,dsi-ctrl-num = <0x00>;
		qcom,display-type = "primary";
		samsung,candela_map_table_revA = <0x00 0x00 0x02 0x05 0x01 0x02 0x02 0x06 0x02 0x03 0x03 0x07 0x03 0x04 0x04 0x08 0x04 0x05 0x05 0x09 0x05 0x06 0x06 0x0a 0x06 0x07 0x07 0x0b 0x07 0x08 0x08 0x0c 0x08 0x09 0x09 0x0d 0x09 0x0a 0x0a 0x0e 0x0a 0x0b 0x0b 0x0f 0x0b 0x0c 0x0c 0x10 0x0c 0x0d 0x0d 0x11 0x0d 0x0e 0x0e 0x13 0x0e 0x0f 0x0f 0x14 0x0f 0x10 0x10 0x15 0x10 0x11 0x11 0x16 0x11 0x12 0x12 0x18 0x12 0x13 0x13 0x19 0x13 0x14 0x14 0x1b 0x14 0x15 0x15 0x1d 0x15 0x16 0x16 0x1e 0x16 0x17 0x18 0x20 0x17 0x19 0x1a 0x22 0x18 0x1b 0x1c 0x25 0x19 0x1d 0x1d 0x27 0x1a 0x1e 0x20 0x29 0x1b 0x21 0x22 0x2c 0x1c 0x23 0x24 0x2f 0x1d 0x25 0x26 0x32 0x1e 0x27 0x28 0x35 0x1f 0x29 0x2b 0x38 0x20 0x2c 0x2e 0x3c 0x21 0x2f 0x31 0x40 0x22 0x32 0x34 0x44 0x23 0x35 0x38 0x48 0x24 0x39 0x3b 0x4d 0x25 0x3c 0x3f 0x52 0x26 0x40 0x43 0x57 0x27 0x44 0x47 0x5d 0x28 0x48 0x4c 0x62 0x29 0x4d 0x50 0x69 0x2a 0x51 0x56 0x6f 0x2b 0x57 0x5b 0x77 0x2c 0x5c 0x61 0x7e 0x2d 0x62 0x68 0x86 0x2e 0x69 0x6e 0x8f 0x2f 0x6f 0x76 0x98 0x30 0x77 0x7d 0xa2 0x31 0x7e 0x85 0xac 0x32 0x86 0x8e 0xb7 0x33 0x8f 0x96 0xc3 0x34 0x97 0xa0 0xcf 0x35 0xa1 0xaa 0xdc 0x36 0xab 0xb5 0xea 0x37 0xb6 0xc1 0xf9 0x38 0xc2 0xcd 0x109 0x39 0xce 0xda 0x11a 0x3a 0xdb 0xe6 0x12c 0x3b 0xe7 0xf2 0x13c 0x3c 0xf3 0xfe 0x14d 0x3d 0xff 0xff 0x168>;
		qcom,mdss-dsi-tx-eot-append;
		qcom,mdss-dsi-rx-eot-ignore;
		qcom,mdss-dsi-lp11-init;
		qcom,adjust-timer-wakeup-ms = <0x01>;
		qcom,mdss-dsi-reset-sequence = <0x00 0x0a 0x01 0x0a>;
		qcom,mdss-dsi-panel-mode-gpio-state = "invalid";
		qcom,mdss-pan-physical-height-dimension = <0x6a>;
		qcom,mdss-pan-physical-width-dimension = <0x3c>;
		qcom,mdss-dsi-dma-trigger = "trigger_sw";
		qcom,mdss-dsi-mdp-trigger = "none";
		qcom,mdss-dsi-stream = <0x00>;
		qcom,mdss-dsi-lane-3-state;
		qcom,mdss-dsi-lane-2-state;
		qcom,mdss-dsi-lane-1-state;
		qcom,mdss-dsi-lane-0-state;
		qcom,mdss-dsi-color-order = "rgb_swap_rgb";
		qcom,mdss-dsi-virtual-channel-id = <0x00>;
		qcom,mdss-dsi-pixel-packing = "loose";
		qcom,mdss-dsi-bllp-power-mode;
		qcom,mdss-dsi-bllp-eof-power-mode;
		qcom,mdss-dsi-traffic-mode = "burst_mode";
		qcom,mdss-dsi-panel-type = "dsi_video_mode";
		qcom,mdss-dsi-interleave-mode = <0x00>;
		qcom,mdss-brightness-max-level = <0x639c>;
		qcom,mdss-dsi-bl-max-level = <0x639c>;
		qcom,mdss-dsi-bl-min-level = <0x00>;
		qcom,mdss-dsi-bl-pmic-control-type = "bl_ctrl_dcs";
		qcom,mdss-dsi-border-color = <0x00>;
		qcom,mdss-dsi-underflow-color = <0xff>;
		qcom,mdss-dsi-bpp = <0x18>;
		label = "ss_dsi_panel_PBA_BOOTING_FHD";
		qcom,mdss-dsi-panel-name = "ss_dsi_panel_PBA_BOOTING_FHD";

		qcom,mdss-dsi-display-timings {

			fhd@0 {
				qcom,mdss-dsi-off-command-state = "dsi_hs_mode";
				qcom,mdss-dsi-on-command-state = "dsi_hs_mode";
				qcom,mdss-dsi-off-command = <0x5010000 0x24000128 0x5010000 0x78000110>;
				qcom,mdss-dsi-on-command = [39 01 00 00 78 00 02 11 00];
				qcom,mdss-dsi-panel-phy-timings = [00 1e 08 08 24 22 22 08 08 02 04 00 1b 18];
				qcom,mdss-dsi-panel-clockrate = <0x35866480>;
				qcom,mdss-dsi-v-front-porch = <0x09>;
				qcom,mdss-dsi-v-back-porch = <0x03>;
				qcom,mdss-dsi-v-pulse-width = <0x04>;
				qcom,mdss-dsi-h-sync-skew = <0x00>;
				qcom,mdss-dsi-h-front-porch = <0xa4>;
				qcom,mdss-dsi-h-back-porch = <0x20>;
				qcom,mdss-dsi-h-pulse-width = <0x0c>;
				qcom,mdss-dsi-panel-framerate = <0x3c>;
				qcom,mdss-dsi-panel-height = <0x780>;
				qcom,mdss-dsi-panel-width = <0x438>;
				qcom,default-topology-index = <0x00>;
				qcom,display-topology = <0x01 0x00 0x01>;
			};
		};
	};
};
