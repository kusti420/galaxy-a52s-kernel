/dts-v1/;

/ {

	fragment@0 {
		target = <0xffffffff>;

		__overlay__ {

			qcom,camera-flash@0 {
				status = "ok";
				torch-source = <0x01>;
				flash-source = <0x02>;
				compatible = "qcom,camera-flash";
				cell-index = <0x00>;
				phandle = <0x0d>;
			};

			qcom,torch_0 {
				qcom,hdrm-vol-hi-lo-win-mv = <0x64>;
				qcom,hdrm-voltage-mv = <0x145>;
				qcom,ires-ua = <0x30d4>;
				qcom,current-ma = <0x12c>;
				qcom,id = <0x00>;
				qcom,default-led-trigger = "torch0_trigger";
				qcom,max-current = <0x1f4>;
				qcom,led-name = "led:torch_0";
				label = "torch";
				phandle = <0x01>;
			};

			qcom,flash_0 {
				qcom,record-current-ma = <0x32>;
				qcom,hdrm-vol-hi-lo-win-mv = <0x64>;
				qcom,hdrm-voltage-mv = <0x145>;
				qcom,ires-ua = <0x30d4>;
				qcom,duration-ms = <0x500>;
				qcom,current-ma = <0x578>;
				qcom,id = <0x00>;
				qcom,default-led-trigger = "flash0_trigger";
				qcom,max-current = <0x5dc>;
				qcom,led-name = "led:flash_0";
				label = "flash";
				phandle = <0x02>;
			};

			qcom,cam-req-mgr {
				compatible = "qcom,cam-req-mgr";
				status = "ok";
			};

			qcom,cam-sync {
				compatible = "qcom,cam-sync";
				status = "ok";
			};

			qcom,cam-res-mgr {
				pinctrl-1 = <0x03>;
				pinctrl-0 = <0x04>;
				pinctrl-names = "cam_res_mgr_default", "cam_res_mgr_suspend";
				shared-gpios = <0x15b>;
				compatible = "qcom,cam-res-mgr";
				status = "ok";
			};

			qcom,csiphy0 {
				cell-index = <0x00>;
				compatible = "qcom,csiphy-v1.2.1", "qcom,csiphy";
				reg = <0xace0000 0x2000>;
				reg-names = "csiphy";
				reg-cam-base = <0xe0000>;
				interrupts = <0x00 0x1dd 0x01>;
				interrupt-names = "csiphy0";
				gdscr-supply = <0xffffffff>;
				refgen-supply = <0xffffffff>;
				csi-vdd-1p2-supply = <0xffffffff>;
				csi-vdd-0p9-supply = <0xffffffff>;
				regulator-names = "gdscr", "refgen", "csi-vdd-1p2", "csi-vdd-0p9";
				rgltr-cntrl-support;
				rgltr-min-voltage = <0x00 0x00 0x124f80 0xd6d80>;
				rgltr-max-voltage = <0x00 0x00 0x1339e0 0x100590>;
				rgltr-load-current = <0x00 0x00 0xd2f0 0x17890>;
				clocks = <0xffffffff 0x1f 0xffffffff 0x2a 0xffffffff 0x21 0xffffffff 0x20>;
				clock-names = "cphy_rx_clk_src", "csiphy0_clk", "csi0phytimer_clk_src", "csi0phytimer_clk";
				src-clock-name = "csi0phytimer_clk_src";
				clock-cntl-level = "lowsvs", "svs";
				clock-rates = <0x11e1a300 0x00 0x11e1a300 0x00 0x17d78400 0x00 0x11e1a300 0x00>;
				status = "ok";
				phandle = <0x3b>;
			};

			qcom,csiphy1 {
				cell-index = <0x01>;
				compatible = "qcom,csiphy-v1.2.1", "qcom,csiphy";
				reg = <0xace2000 0x2000>;
				reg-names = "csiphy";
				reg-cam-base = <0xe2000>;
				interrupts = <0x00 0x1de 0x01>;
				interrupt-names = "csiphy1";
				gdscr-supply = <0xffffffff>;
				refgen-supply = <0xffffffff>;
				csi-vdd-1p2-supply = <0xffffffff>;
				csi-vdd-0p9-supply = <0xffffffff>;
				regulator-names = "gdscr", "refgen", "csi-vdd-1p2", "csi-vdd-0p9";
				rgltr-cntrl-support;
				rgltr-min-voltage = <0x00 0x00 0x124f80 0xd6d80>;
				rgltr-max-voltage = <0x00 0x00 0x1339e0 0x100590>;
				rgltr-load-current = <0x00 0x00 0xd2f0 0x17890>;
				clocks = <0xffffffff 0x1f 0xffffffff 0x2b 0xffffffff 0x23 0xffffffff 0x22>;
				clock-names = "cphy_rx_clk_src", "csiphy1_clk", "csi1phytimer_clk_src", "csi1phytimer_clk";
				src-clock-name = "csi1phytimer_clk_src";
				clock-cntl-level = "lowsvs", "svs";
				clock-rates = <0x11e1a300 0x00 0x11e1a300 0x00 0x17d78400 0x00 0x11e1a300 0x00>;
				status = "ok";
				phandle = <0x3c>;
			};

			qcom,csiphy2 {
				cell-index = <0x02>;
				compatible = "qcom,csiphy-v1.2.1", "qcom,csiphy";
				reg = <0xace4000 0x2000>;
				reg-names = "csiphy";
				reg-cam-base = <0xe4000>;
				interrupts = <0x00 0x1df 0x01>;
				interrupt-names = "csiphy2";
				gdscr-supply = <0xffffffff>;
				refgen-supply = <0xffffffff>;
				csi-vdd-1p2-supply = <0xffffffff>;
				csi-vdd-0p9-supply = <0xffffffff>;
				regulator-names = "gdscr", "refgen", "csi-vdd-1p2", "csi-vdd-0p9";
				rgltr-cntrl-support;
				rgltr-min-voltage = <0x00 0x00 0x124f80 0xd6d80>;
				rgltr-max-voltage = <0x00 0x00 0x1339e0 0x100590>;
				rgltr-load-current = <0x00 0x00 0xd2f0 0x17890>;
				clocks = <0xffffffff 0x1f 0xffffffff 0x2c 0xffffffff 0x25 0xffffffff 0x24>;
				clock-names = "cphy_rx_clk_src", "csiphy2_clk", "csi2phytimer_clk_src", "csi2phytimer_clk";
				src-clock-name = "csi2phytimer_clk_src";
				clock-cntl-level = "lowsvs", "svs";
				clock-rates = <0x11e1a300 0x00 0x11e1a300 0x00 0x17d78400 0x00 0x11e1a300 0x00>;
				status = "ok";
				phandle = <0x3d>;
			};

			qcom,csiphy3 {
				cell-index = <0x03>;
				compatible = "qcom,csiphy-v1.2.1", "qcom,csiphy";
				reg = <0xace6000 0x2000>;
				reg-names = "csiphy";
				reg-cam-base = <0xe6000>;
				interrupts = <0x00 0x1c0 0x01>;
				interrupt-names = "csiphy3";
				gdscr-supply = <0xffffffff>;
				refgen-supply = <0xffffffff>;
				csi-vdd-1p2-supply = <0xffffffff>;
				csi-vdd-0p9-supply = <0xffffffff>;
				regulator-names = "gdscr", "refgen", "csi-vdd-1p2", "csi-vdd-0p9";
				rgltr-cntrl-support;
				rgltr-min-voltage = <0x00 0x00 0x124f80 0xd6d80>;
				rgltr-max-voltage = <0x00 0x00 0x1339e0 0x100590>;
				rgltr-load-current = <0x00 0x00 0xd2f0 0x17890>;
				clocks = <0xffffffff 0x1f 0xffffffff 0x2d 0xffffffff 0x27 0xffffffff 0x26>;
				clock-names = "cphy_rx_clk_src", "csiphy3_clk", "csi3phytimer_clk_src", "csi3phytimer_clk";
				src-clock-name = "csi3phytimer_clk_src";
				clock-cntl-level = "lowsvs", "svs";
				clock-rates = <0x11e1a300 0x00 0x11e1a300 0x00 0x17d78400 0x00 0x11e1a300 0x00>;
				status = "ok";
				phandle = <0x3e>;
			};

			qcom,csiphy4 {
				cell-index = <0x04>;
				compatible = "qcom,csiphy-v1.2.1", "qcom,csiphy";
				reg = <0xace8000 0x2000>;
				reg-names = "csiphy";
				reg-cam-base = <0xe8000>;
				interrupts = <0x00 0x7a 0x01>;
				interrupt-names = "csiphy4";
				gdscr-supply = <0xffffffff>;
				refgen-supply = <0xffffffff>;
				csi-vdd-1p2-supply = <0xffffffff>;
				csi-vdd-0p9-supply = <0xffffffff>;
				regulator-names = "gdscr", "refgen", "csi-vdd-1p2", "csi-vdd-0p9";
				rgltr-cntrl-support;
				rgltr-min-voltage = <0x00 0x00 0x124f80 0xd6d80>;
				rgltr-max-voltage = <0x00 0x00 0x1339e0 0x100590>;
				rgltr-load-current = <0x00 0x00 0xd2f0 0x17890>;
				clocks = <0xffffffff 0x1f 0xffffffff 0x2e 0xffffffff 0x29 0xffffffff 0x28>;
				clock-names = "cphy_rx_clk_src", "csiphy4_clk", "csi4phytimer_clk_src", "csi4phytimer_clk";
				src-clock-name = "csi4phytimer_clk_src";
				clock-cntl-level = "lowsvs", "svs";
				clock-rates = <0x11e1a300 0x00 0x11e1a300 0x00 0x17d78400 0x00 0x11e1a300 0x00>;
				status = "ok";
				phandle = <0x3f>;
			};

			qcom,cci0 {
				cell-index = <0x00>;
				compatible = "qcom,cci", "simple-bus";
				reg = <0xac4a000 0x1000>;
				reg-names = "cci";
				reg-cam-base = <0x4a000>;
				interrupt-names = "cci";
				interrupts = <0x00 0x1cc 0x01>;
				status = "ok";
				gdscr-supply = <0xffffffff>;
				regulator-names = "gdscr";
				clocks = <0xffffffff 0x1a 0xffffffff 0x19>;
				clock-names = "cci_0_clk_src", "cci_0_clk";
				src-clock-name = "cci_0_clk_src";
				clock-cntl-level = "lowsvs";
				clock-rates = <0x23c3460 0x00>;
				pinctrl-names = "cam_default", "cam_suspend";
				pinctrl-0 = <0xffffffff 0xffffffff>;
				pinctrl-1 = <0xffffffff 0xffffffff>;
				gpios = <0xffffffff 0x45 0x00 0xffffffff 0x46 0x00 0xffffffff 0x47 0x00 0xffffffff 0x48 0x00>;
				gpio-req-tbl-num = <0x00 0x01 0x02 0x03>;
				gpio-req-tbl-flags = <0x01 0x01 0x01 0x01>;
				gpio-req-tbl-label = "CCI_I2C_DATA0", "CCI_I2C_CLK0", "CCI_I2C_DATA1", "CCI_I2C_CLK1";
				phandle = <0x40>;

				qcom,cam-sensor0 {
					cam,valid = <0x01>;
					cam,dual_open = <0x00>;
					cam,ois = <0x01>;
					cam,companion_chip = <0x00>;
					cam,fw_dump = <0x01>;
					cam,fw_write = <0x03>;
					cam,upgrade = <0x02>;
					cam,core_voltage = <0x01>;
					cam,read_version = <0x01>;
					cam,cal_memory = <0x02>;
					cam,isp = <0x00>;
					clock-rates = <0x124f800>;
					clock-cntl-level = "turbo";
					clock-names = "cam_clk";
					clocks = <0xffffffff 0x5c>;
					status = "ok";
					cci-master = <0x00>;
					sensor-mode = <0x00>;
					gpio-req-tbl-label = "CAMIF_MCLK0", "CAM_RESET0", "CAM_VANA0";
					gpio-req-tbl-flags = <0x01 0x00 0x00>;
					gpio-req-tbl-num = <0x00 0x01 0x02>;
					gpio-vana = <0x02>;
					gpio-reset = <0x01>;
					gpios = <0xffffffff 0x40 0x00 0xffffffff 0x14 0x00 0xffffffff 0x0b 0x00>;
					pinctrl-1 = <0x05 0xffffffff 0x06>;
					pinctrl-0 = <0x07 0xffffffff 0x08>;
					pinctrl-names = "cam_default", "cam_suspend";
					use-shared-clk;
					gpio-no-mux = <0x00>;
					rgltr-load-current = <0x30d40 0x30d40 0x1388 0x30d40 0x00>;
					rgltr-max-voltage = <0x10c8e0 0x1b7740 0x2ab980 0x2ab980 0x00>;
					rgltr-min-voltage = <0x10c8e0 0x1b7740 0x2ab980 0x2ab980 0x00>;
					rgltr-cntrl-support;
					regulator-names = "cam_vdig", "cam_vio", "cam_vana", "cam_vaf", "cam_clk";
					cam_clk-supply = <0xffffffff>;
					cam_vaf-supply = <0x09>;
					cam_vana-supply = <0x0a>;
					cam_vio-supply = <0x0b>;
					cam_vdig-supply = <0x0c>;
					led-flash-src = <0x0d>;
					ois-src = <0x0e>;
					eeprom-src = <0x0f>;
					actuator-src = <0x10>;
					sensor-position-yaw = <0xb4>;
					sensor-position-pitch = <0x00>;
					sensor-position-roll = <0x5a>;
					csiphy-sd-index = <0x00>;
					compatible = "qcom,cam-sensor";
					cell-index = <0x00>;
					phandle = <0x41>;
				};

				qcom,i2c_standard_mode {
					hw-thigh = <0xc9>;
					hw-tlow = <0xae>;
					hw-tsu-sto = <0xcc>;
					hw-tsu-sta = <0xe7>;
					hw-thd-dat = <0x16>;
					hw-thd-sta = <0xa2>;
					hw-tbuf = <0xe3>;
					hw-scl-stretch-en = <0x00>;
					hw-trdhld = <0x06>;
					hw-tsp = <0x03>;
					cci-clk-src = <0x23c3460>;
					status = "ok";
					phandle = <0x42>;
				};

				qcom,i2c_fast_mode {
					hw-thigh = <0x26>;
					hw-tlow = <0x38>;
					hw-tsu-sto = <0x28>;
					hw-tsu-sta = <0x28>;
					hw-thd-dat = <0x16>;
					hw-thd-sta = <0x23>;
					hw-tbuf = <0x3e>;
					hw-scl-stretch-en = <0x00>;
					hw-trdhld = <0x06>;
					hw-tsp = <0x03>;
					cci-clk-src = <0x23c3460>;
					status = "ok";
					phandle = <0x43>;
				};

				qcom,i2c_custom_mode {
					hw-thigh = <0x26>;
					hw-tlow = <0x38>;
					hw-tsu-sto = <0x28>;
					hw-tsu-sta = <0x28>;
					hw-thd-dat = <0x16>;
					hw-thd-sta = <0x23>;
					hw-tbuf = <0x3e>;
					hw-scl-stretch-en = <0x01>;
					hw-trdhld = <0x06>;
					hw-tsp = <0x03>;
					cci-clk-src = <0x23c3460>;
					status = "ok";
					phandle = <0x44>;
				};

				qcom,i2c_fast_plus_mode {
					hw-thigh = <0x10>;
					hw-tlow = <0x16>;
					hw-tsu-sto = <0x11>;
					hw-tsu-sta = <0x12>;
					hw-thd-dat = <0x10>;
					hw-thd-sta = <0x0f>;
					hw-tbuf = <0x18>;
					hw-scl-stretch-en = <0x00>;
					hw-trdhld = <0x03>;
					hw-tsp = <0x03>;
					cci-clk-src = <0x23c3460>;
					status = "ok";
					phandle = <0x45>;
				};
			};

			qcom,cci1 {
				cell-index = <0x01>;
				compatible = "qcom,cci", "simple-bus";
				reg = <0xac4b000 0x1000>;
				reg-names = "cci";
				reg-cam-base = <0x4b000>;
				interrupt-names = "cci";
				interrupts = <0x00 0x10f 0x01>;
				status = "ok";
				gdscr-supply = <0xffffffff>;
				regulator-names = "gdscr";
				clocks = <0xffffffff 0x1c 0xffffffff 0x1b>;
				clock-names = "cci_1_clk_src", "cci_1_clk";
				src-clock-name = "cci_1_clk_src";
				clock-cntl-level = "lowsvs";
				clock-rates = <0x23c3460 0x00>;
				pinctrl-names = "cam_default", "cam_suspend";
				pinctrl-0 = <0xffffffff 0xffffffff>;
				pinctrl-1 = <0xffffffff 0xffffffff>;
				gpios = <0xffffffff 0x49 0x00 0xffffffff 0x4a 0x00 0xffffffff 0x4b 0x00 0xffffffff 0x4c 0x00>;
				gpio-req-tbl-num = <0x00 0x01 0x02 0x03>;
				gpio-req-tbl-flags = <0x01 0x01 0x01 0x01>;
				gpio-req-tbl-label = "CCI_I2C_DATA2", "CCI_I2C_CLK2", "CCI_I2C_DATA3", "CCI_I2C_CLK3";
				phandle = <0x46>;

				qcom,actuator@0xC {
					qcom,cam-power-seq-delay = <0x01 0x0c>;
					qcom,cam-power-seq-cfg-val = <0x01 0x01>;
					qcom,cam-power-seq-type = "cam_vio", "cam_vaf";
					rgltr-load-current = <0x30d40 0x30d40>;
					rgltr-max-voltage = <0x1b7740 0x2ab980>;
					rgltr-min-voltage = <0x1b7740 0x2ab980>;
					rgltr-cntrl-support;
					regulator-names = "cam_vio", "cam_vaf";
					cam_vaf-supply = <0x09>;
					cam_vio-supply = <0x0b>;
					i2c-freq-mode = <0x03>;
					compatible = "qcom,actuator";
					cci-master = <0x01>;
					cci-device = <0x01>;
					slave-addr = <0x18>;
					reg = <0x0c>;
					cell-index = <0x00>;
					phandle = <0x10>;
				};

				qcom,eeprom@0x3F {
					cam,valid = <0x01>;
					cam,dual_open = <0x00>;
					cam,ois = <0x00>;
					cam,companion_chip = <0x00>;
					cam,fw_dump = <0x01>;
					cam,fw_write = <0x03>;
					cam,upgrade = <0x02>;
					cam,core_voltage = <0x01>;
					cam,read_version = <0x01>;
					cam,cal_memory = <0x02>;
					cam,isp = <0x00>;
					clock-rates = <0x16e3600>;
					clock-cntl-level = "turbo";
					clock-names = "cam_clk";
					clocks = <0xffffffff 0x62>;
					status = "ok";
					cci-master = <0x00>;
					cci-device = <0x01>;
					sensor-mode = <0x00>;
					gpio-req-tbl-label = "CAMIF_MCLK3", "CAM_RESET3", "CAM_VANA1";
					gpio-req-tbl-flags = <0x01 0x00 0x00>;
					gpio-req-tbl-num = <0x00 0x01 0x02>;
					gpio-vana = <0x02>;
					gpio-reset = <0x01>;
					gpios = <0xffffffff 0x43 0x00 0xffffffff 0x4e 0x00 0xffffffff 0x0e 0x00>;
					pinctrl-1 = <0x11 0xffffffff 0x12>;
					pinctrl-0 = <0x13 0xffffffff 0x14>;
					pinctrl-names = "cam_default", "cam_suspend";
					use-shared-clk;
					gpio-no-mux = <0x00>;
					rgltr-load-current = <0x30d40 0x30d40 0x00>;
					rgltr-max-voltage = <0x124f80 0x1b7740 0x00>;
					rgltr-min-voltage = <0x124f80 0x1b7740 0x00>;
					rgltr-cntrl-support;
					regulator-names = "cam_vdig", "cam_vio", "cam_clk";
					cam_clk-supply = <0xffffffff>;
					cam_vio-supply = <0x0b>;
					cam_vdig-supply = <0x15>;
					sensor-position-yaw = <0xb4>;
					sensor-position-pitch = <0x00>;
					sensor-position-roll = <0x5a>;
					csiphy-sd-index = <0x02>;
					sub-type = <0x02>;
					i2c-freq-mode = <0x01>;
					compatible = "qcom,eeprom";
					slave-addr = <0x7e>;
					reg = <0x3f>;
					cell-index = <0x04>;
					phandle = <0x1c>;
				};

				qcom,eeprom@37 {
					cam,valid = <0x01>;
					cam,dual_open = <0x00>;
					cam,ois = <0x00>;
					cam,companion_chip = <0x00>;
					cam,fw_dump = <0x01>;
					cam,fw_write = <0x03>;
					cam,upgrade = <0x02>;
					cam,core_voltage = <0x01>;
					cam,read_version = <0x01>;
					cam,cal_memory = <0x02>;
					cam,isp = <0x00>;
					clock-rates = <0x16e3600>;
					clock-cntl-level = "turbo";
					clock-names = "cam_clk";
					clocks = <0xffffffff 0x5e>;
					status = "ok";
					cci-master = <0x00>;
					cci-device = <0x01>;
					sensor-mode = <0x00>;
					gpio-req-tbl-label = "CAMIF_MCLK1", "CAM_RESET1", "CAM_VANA1";
					gpio-req-tbl-flags = <0x01 0x00 0x00>;
					gpio-req-tbl-num = <0x00 0x01 0x02>;
					gpio-vana = <0x02>;
					gpio-reset = <0x01>;
					gpios = <0xffffffff 0x41 0x00 0xffffffff 0x15 0x00 0xffffffff 0x0e 0x00>;
					pinctrl-1 = <0x16 0xffffffff 0x12>;
					pinctrl-0 = <0x17 0xffffffff 0x14>;
					pinctrl-names = "cam_default", "cam_suspend";
					gpio-no-mux = <0x00>;
					rgltr-load-current = <0x30d40 0x30d40 0x00>;
					rgltr-max-voltage = <0x1b7740 0x124f80 0x00>;
					rgltr-min-voltage = <0x1b7740 0x124f80 0x00>;
					rgltr-cntrl-support;
					regulator-names = "cam_vio", "cam_vdig", "cam_clk";
					cam_clk-supply = <0xffffffff>;
					cam_vdig-supply = <0x15>;
					cam_vio-supply = <0x0b>;
					sub-type = <0x02>;
					sensor-position-yaw = <0xb4>;
					sensor-position-pitch = <0x00>;
					sensor-position-roll = <0x5a>;
					csiphy-sd-index = <0x01>;
					slave-addr = <0x6e>;
					i2c-freq-mode = <0x01>;
					compatible = "qcom,eeprom";
					reg = <0x37>;
					cell-index = <0x03>;
					phandle = <0x23>;
				};

				qcom,eeprom@0x2D {
					cam,valid = <0x01>;
					cam,dual_open = <0x00>;
					cam,ois = <0x00>;
					cam,companion_chip = <0x00>;
					cam,fw_dump = <0x01>;
					cam,fw_write = <0x03>;
					cam,upgrade = <0x02>;
					cam,core_voltage = <0x01>;
					cam,read_version = <0x01>;
					cam,cal_memory = <0x02>;
					cam,isp = <0x00>;
					clock-rates = <0x16e3600>;
					clock-cntl-level = "turbo";
					clock-names = "cam_clk";
					clocks = <0xffffffff 0x60>;
					status = "ok";
					cci-master = <0x00>;
					cci-device = <0x01>;
					sensor-mode = <0x00>;
					gpio-req-tbl-label = "CAMIF_MCLK2", "CAM_RESET2", "CAM_VANA2";
					gpio-req-tbl-flags = <0x01 0x00 0x00>;
					gpio-req-tbl-num = <0x00 0x01 0x02>;
					gpio-vana = <0x02>;
					gpio-reset = <0x01>;
					gpios = <0xffffffff 0x42 0x00 0xffffffff 0x4d 0x00 0xffffffff 0x0f 0x00>;
					pinctrl-1 = <0x18 0xffffffff 0x19>;
					pinctrl-0 = <0x1a 0xffffffff 0x1b>;
					pinctrl-names = "cam_default", "cam_suspend";
					use-shared-clk;
					gpio-no-mux = <0x00>;
					rgltr-load-current = <0x30d40 0x00>;
					rgltr-max-voltage = <0x1b7740 0x00>;
					rgltr-min-voltage = <0x1b7740 0x00>;
					rgltr-cntrl-support;
					regulator-names = "cam_vio", "cam_clk";
					cam_clk-supply = <0xffffffff>;
					cam_vio-supply = <0x0b>;
					sub-type = <0x02>;
					sensor-position-yaw = <0xb4>;
					sensor-position-pitch = <0x00>;
					sensor-position-roll = <0x5a>;
					csiphy-sd-index = <0x02>;
					i2c-freq-mode = <0x01>;
					compatible = "qcom,eeprom";
					slave-addr = <0x5a>;
					reg = <0x2d>;
					cell-index = <0x02>;
					phandle = <0x22>;
				};

				qcom,eeprom@51 {
					rgltr-cntrl-support;
					sensor-position = <0x01>;
					rgltr-load-current = <0x30d40>;
					rgltr-max-voltage = <0x1b7740>;
					rgltr-min-voltage = <0x1b7740>;
					regulator-names = "cam_vio";
					cam_vio-supply = <0x0b>;
					qcom,cam-power-seq-delay = <0x02>;
					qcom,cam-power-seq-cfg-val = <0x01>;
					qcom,cam-power-seq-val = "cam_vio";
					qcom,cam-power-seq-type = "sensor_vreg";
					sub-type = <0x02>;
					cci-master = <0x01>;
					cci-device = <0x01>;
					sensor-mode = <0x01>;
					slave-addr = <0xa2>;
					i2c-freq-mode = <0x01>;
					compatible = "qcom,eeprom";
					reg = <0x51>;
					cell-index = <0x01>;
					phandle = <0x21>;
				};

				qcom,eeprom@50 {
					gpio-no-mux = <0x00>;
					sensor-position = <0x00>;
					rgltr-load-current = <0x30d40 0x30d40>;
					rgltr-max-voltage = <0x2ab980 0x1b7740>;
					rgltr-min-voltage = <0x2ab980 0x1b7740>;
					qcom,cam-power-seq-delay = <0x02 0x02>;
					qcom,cam-power-seq-cfg-val = <0x01 0x01>;
					qcom,cam-power-seq-val = "cam_vaf", "cam_vio";
					qcom,cam-power-seq-type = "sensor_vreg", "sensor_vreg";
					sub-type = <0x02>;
					cci-master = <0x01>;
					cci-device = <0x01>;
					sensor-mode = <0x00>;
					slave-addr = <0xa0>;
					rgltr-cntrl-support;
					regulator-names = "cam_vaf", "cam_vio";
					cam_vio-supply = <0x0b>;
					cam_vaf-supply = <0x09>;
					i2c-freq-mode = <0x01>;
					compatible = "qcom,eeprom";
					reg = <0x50>;
					cell-index = <0x00>;
					phandle = <0x0f>;
				};

				qcom,cam-sensor4 {
					cam,valid = <0x01>;
					cam,dual_open = <0x00>;
					cam,ois = <0x00>;
					cam,companion_chip = <0x00>;
					cam,fw_dump = <0x00>;
					cam,fw_write = <0x00>;
					cam,upgrade = <0x00>;
					cam,core_voltage = <0x00>;
					cam,read_version = <0x00>;
					cam,cal_memory = <0x02>;
					cam,isp = <0x00>;
					clock-rates = <0x16e3600>;
					clock-cntl-level = "turbo";
					clock-names = "cam_clk";
					clocks = <0xffffffff 0x62>;
					status = "ok";
					cci-master = <0x00>;
					cci-device = <0x01>;
					sensor-mode = <0x00>;
					gpio-req-tbl-label = "CAMIF_MCLK3", "CAM_RESET3", "CAM_VANA1";
					gpio-req-tbl-flags = <0x01 0x00 0x00>;
					gpio-req-tbl-num = <0x00 0x01 0x02>;
					gpio-vana = <0x02>;
					gpio-reset = <0x01>;
					gpios = <0xffffffff 0x43 0x00 0xffffffff 0x4e 0x00 0xffffffff 0x0e 0x00>;
					pinctrl-1 = <0x11 0xffffffff 0x12 0x06>;
					pinctrl-0 = <0x13 0xffffffff 0x14 0x08>;
					pinctrl-names = "cam_default", "cam_suspend";
					use-shared-clk;
					gpio-no-mux = <0x00>;
					rgltr-load-current = <0x30d40 0x30d40 0x00>;
					rgltr-max-voltage = <0x124f80 0x1b7740 0x00>;
					rgltr-min-voltage = <0x124f80 0x1b7740 0x00>;
					rgltr-cntrl-support;
					regulator-names = "cam_vdig", "cam_vio", "cam_clk";
					cam_clk-supply = <0xffffffff>;
					cam_vio-supply = <0x0b>;
					cam_vdig-supply = <0x15>;
					eeprom-src = <0x1c>;
					led-flash-src = <0x0d>;
					sensor-position-yaw = <0xb4>;
					sensor-position-pitch = <0x00>;
					sensor-position-roll = <0x5a>;
					csiphy-sd-index = <0x03>;
					compatible = "qcom,cam-sensor";
					cell-index = <0x04>;
					phandle = <0x47>;
				};

				qcom,cam-sensor13 {
					cam,valid = <0x01>;
					cam,dual_open = <0x00>;
					cam,ois = <0x00>;
					cam,companion_chip = <0x00>;
					cam,fw_dump = <0x00>;
					cam,fw_write = <0x00>;
					cam,upgrade = <0x00>;
					cam,core_voltage = <0x00>;
					cam,read_version = <0x00>;
					cam,cal_memory = <0x02>;
					cam,isp = <0x00>;
					clock-rates = <0x16e3600>;
					clock-cntl-level = "turbo";
					clock-names = "cam_clk";
					clocks = <0xffffffff 0x64>;
					status = "ok";
					cci-master = <0x00>;
					cci-device = <0x01>;
					sensor-mode = <0x00>;
					gpio-req-tbl-label = "CAMIF_MCLK4", "CAM_RESET4";
					gpio-req-tbl-flags = <0x01 0x00>;
					gpio-req-tbl-num = <0x00 0x01>;
					gpio-reset = <0x01>;
					gpios = <0xffffffff 0x44 0x00 0xffffffff 0x4f 0x00>;
					pinctrl-1 = <0x1d 0xffffffff>;
					pinctrl-0 = <0x1e 0xffffffff>;
					pinctrl-names = "cam_default", "cam_suspend";
					gpio-no-mux = <0x00>;
					rgltr-load-current = <0x30d40 0x30d40 0x1388 0x00>;
					rgltr-max-voltage = <0x100590 0x1b7740 0x2c4020 0x00>;
					rgltr-min-voltage = <0x100590 0x1b7740 0x2c4020 0x00>;
					rgltr-cntrl-support;
					regulator-names = "cam_vdig", "cam_vio", "cam_vana", "cam_clk";
					cam_clk-supply = <0xffffffff>;
					cam_vana-supply = <0x1f>;
					cam_vio-supply = <0x0b>;
					cam_vdig-supply = <0x20>;
					eeprom-src = <0x21>;
					sensor-position-yaw = <0x00>;
					sensor-position-pitch = <0x00>;
					sensor-position-roll = <0x10e>;
					csiphy-sd-index = <0x04>;
					compatible = "qcom,cam-sensor";
					cell-index = <0x0d>;
					phandle = <0x48>;
				};

				qcom,cam-sensor1 {
					cam,valid = <0x01>;
					cam,dual_open = <0x00>;
					cam,ois = <0x00>;
					cam,companion_chip = <0x00>;
					cam,fw_dump = <0x00>;
					cam,fw_write = <0x00>;
					cam,upgrade = <0x00>;
					cam,core_voltage = <0x00>;
					cam,read_version = <0x00>;
					cam,cal_memory = <0x02>;
					cam,isp = <0x00>;
					clock-rates = <0x16e3600>;
					clock-cntl-level = "turbo";
					clock-names = "cam_clk";
					clocks = <0xffffffff 0x64>;
					status = "ok";
					cci-master = <0x00>;
					cci-device = <0x01>;
					sensor-mode = <0x00>;
					gpio-req-tbl-label = "CAMIF_MCLK4", "CAM_RESET4";
					gpio-req-tbl-flags = <0x01 0x00>;
					gpio-req-tbl-num = <0x00 0x01>;
					gpio-reset = <0x01>;
					gpios = <0xffffffff 0x44 0x00 0xffffffff 0x4f 0x00>;
					pinctrl-1 = <0x1d 0xffffffff>;
					pinctrl-0 = <0x1e 0xffffffff>;
					pinctrl-names = "cam_default", "cam_suspend";
					gpio-no-mux = <0x00>;
					rgltr-load-current = <0x30d40 0x30d40 0x1388 0x00>;
					rgltr-max-voltage = <0x100590 0x1b7740 0x2c4020 0x00>;
					rgltr-min-voltage = <0x100590 0x1b7740 0x2c4020 0x00>;
					rgltr-cntrl-support;
					regulator-names = "cam_vdig", "cam_vio", "cam_vana", "cam_clk";
					cam_clk-supply = <0xffffffff>;
					cam_vana-supply = <0x1f>;
					cam_vio-supply = <0x0b>;
					cam_vdig-supply = <0x20>;
					eeprom-src = <0x21>;
					sensor-position-yaw = <0x00>;
					sensor-position-pitch = <0x00>;
					sensor-position-roll = <0x10e>;
					csiphy-sd-index = <0x04>;
					compatible = "qcom,cam-sensor";
					cell-index = <0x01>;
					phandle = <0x49>;
				};

				qcom,cam-sensor2 {
					cam,valid = <0x01>;
					cam,dual_open = <0x00>;
					cam,ois = <0x00>;
					cam,companion_chip = <0x00>;
					cam,fw_dump = <0x00>;
					cam,fw_write = <0x00>;
					cam,upgrade = <0x00>;
					cam,core_voltage = <0x00>;
					cam,read_version = <0x00>;
					cam,cal_memory = <0x02>;
					cam,isp = <0x00>;
					clock-rates = <0x124f800>;
					clock-cntl-level = "turbo";
					clock-names = "cam_clk";
					clocks = <0xffffffff 0x60>;
					status = "ok";
					cci-master = <0x00>;
					cci-device = <0x01>;
					sensor-mode = <0x00>;
					gpio-req-tbl-label = "CAMIF_MCLK2", "CAM_RESET2", "CAM_VANA2";
					gpio-req-tbl-flags = <0x01 0x00 0x00>;
					gpio-req-tbl-num = <0x00 0x01 0x02>;
					gpio-vana = <0x02>;
					gpio-reset = <0x01>;
					gpios = <0xffffffff 0x42 0x00 0xffffffff 0x4d 0x00 0xffffffff 0x0f 0x00>;
					pinctrl-1 = <0x18 0xffffffff 0x19>;
					pinctrl-0 = <0x1a 0xffffffff 0x1b>;
					pinctrl-names = "cam_default", "cam_suspend";
					gpio-no-mux = <0x00>;
					rgltr-load-current = <0x30d40 0x00>;
					rgltr-max-voltage = <0x1b7740 0x00>;
					rgltr-min-voltage = <0x1b7740 0x00>;
					rgltr-cntrl-support;
					regulator-names = "cam_vio", "cam_clk";
					cam_clk-supply = <0xffffffff>;
					cam_vio-supply = <0x0b>;
					eeprom-src = <0x22>;
					sensor-position-yaw = <0xb4>;
					sensor-position-pitch = <0x00>;
					sensor-position-roll = <0x5a>;
					csiphy-sd-index = <0x02>;
					compatible = "qcom,cam-sensor";
					cell-index = <0x02>;
					phandle = <0x4a>;
				};

				qcom,cam-sensor3 {
					cam,valid = <0x01>;
					cam,dual_open = <0x00>;
					cam,ois = <0x00>;
					cam,companion_chip = <0x00>;
					cam,fw_dump = <0x00>;
					cam,fw_write = <0x00>;
					cam,upgrade = <0x00>;
					cam,core_voltage = <0x00>;
					cam,read_version = <0x00>;
					cam,cal_memory = <0x02>;
					cam,isp = <0x00>;
					clock-rates = <0x16e3600>;
					clock-cntl-level = "turbo";
					clock-names = "cam_clk";
					clocks = <0xffffffff 0x5e>;
					status = "ok";
					cci-master = <0x00>;
					cci-device = <0x01>;
					sensor-mode = <0x00>;
					gpio-req-tbl-label = "CAMIF_MCLK1", "CAM_RESET1", "CAM_VANA1";
					gpio-req-tbl-flags = <0x01 0x00 0x00>;
					gpio-req-tbl-num = <0x00 0x01 0x02>;
					gpio-vana = <0x02>;
					gpio-reset = <0x01>;
					gpios = <0xffffffff 0x41 0x00 0xffffffff 0x15 0x00 0xffffffff 0x0e 0x00>;
					pinctrl-1 = <0x16 0xffffffff 0x12>;
					pinctrl-0 = <0x17 0xffffffff 0x14>;
					pinctrl-names = "cam_default", "cam_suspend";
					use-shared-clk;
					gpio-no-mux = <0x00>;
					rgltr-load-current = <0x30d40 0x30d40 0x00>;
					rgltr-max-voltage = <0x124f80 0x1b7740 0x00>;
					rgltr-min-voltage = <0x124f80 0x1b7740 0x00>;
					rgltr-cntrl-support;
					regulator-names = "cam_vdig", "cam_vio", "cam_clk";
					cam_clk-supply = <0xffffffff>;
					cam_vio-supply = <0x0b>;
					cam_vdig-supply = <0x15>;
					eeprom-src = <0x23>;
					sensor-position-yaw = <0xb4>;
					sensor-position-pitch = <0x00>;
					sensor-position-roll = <0x5a>;
					csiphy-sd-index = <0x01>;
					compatible = "qcom,cam-sensor";
					cell-index = <0x03>;
					phandle = <0x4b>;
				};

				qcom,i2c_standard_mode {
					hw-thigh = <0xc9>;
					hw-tlow = <0xae>;
					hw-tsu-sto = <0xcc>;
					hw-tsu-sta = <0xe7>;
					hw-thd-dat = <0x16>;
					hw-thd-sta = <0xa2>;
					hw-tbuf = <0xe3>;
					hw-scl-stretch-en = <0x00>;
					hw-trdhld = <0x06>;
					hw-tsp = <0x03>;
					cci-clk-src = <0x23c3460>;
					status = "ok";
					phandle = <0x4c>;
				};

				qcom,i2c_fast_mode {
					hw-thigh = <0x26>;
					hw-tlow = <0x38>;
					hw-tsu-sto = <0x28>;
					hw-tsu-sta = <0x28>;
					hw-thd-dat = <0x16>;
					hw-thd-sta = <0x23>;
					hw-tbuf = <0x3e>;
					hw-scl-stretch-en = <0x00>;
					hw-trdhld = <0x06>;
					hw-tsp = <0x03>;
					cci-clk-src = <0x23c3460>;
					status = "ok";
					phandle = <0x4d>;
				};

				qcom,i2c_custom_mode {
					hw-thigh = <0x26>;
					hw-tlow = <0x38>;
					hw-tsu-sto = <0x28>;
					hw-tsu-sta = <0x28>;
					hw-thd-dat = <0x16>;
					hw-thd-sta = <0x23>;
					hw-tbuf = <0x3e>;
					hw-scl-stretch-en = <0x01>;
					hw-trdhld = <0x06>;
					hw-tsp = <0x03>;
					cci-clk-src = <0x23c3460>;
					status = "ok";
					phandle = <0x4e>;
				};

				qcom,i2c_fast_plus_mode {
					hw-thigh = <0x10>;
					hw-tlow = <0x16>;
					hw-tsu-sto = <0x11>;
					hw-tsu-sta = <0x12>;
					hw-thd-dat = <0x10>;
					hw-thd-sta = <0x0f>;
					hw-tbuf = <0x18>;
					hw-scl-stretch-en = <0x00>;
					hw-trdhld = <0x03>;
					hw-tsp = <0x03>;
					cci-clk-src = <0x23c3460>;
					status = "ok";
					phandle = <0x4f>;
				};
			};

			qcom,cam_smmu {
				compatible = "qcom,msm-cam-smmu", "simple-bus";
				status = "ok";

				msm_cam_smmu_ife {
					compatible = "qcom,msm-cam-smmu-cb";
					iommus = <0xffffffff 0x800 0x4e0 0xffffffff 0x820 0x4e0 0xffffffff 0x840 0x4e0 0xffffffff 0x860 0x4e0 0xffffffff 0x880 0x4e0 0xffffffff 0x8a0 0x4e0 0xffffffff 0x8c0 0x4e0 0xffffffff 0x8e0 0x4e0 0xffffffff 0xc00 0x4e0 0xffffffff 0xc20 0x4e0 0xffffffff 0xc40 0x4e0 0xffffffff 0xc60 0x4e0 0xffffffff 0xc80 0x4e0 0xffffffff 0xca0 0x4e0 0xffffffff 0xcc0 0x4e0 0xffffffff 0xce0 0x4e0>;
					qcom,iommu-faults = "stall-disable", "HUPCF", "non-fatal";
					dma-coherent-hint-cached;
					cam-smmu-label = "ife";
					stall-disable;
					multiple-client-devices;
					memory-region = <0x24>;
					phandle = <0x36>;

					iova-mem-map {
						phandle = <0x50>;

						iova-mem-region-io {
							iova-region-name = "io";
							iova-region-start = <0x100000>;
							iova-region-len = <0xffe00000>;
							iova-region-id = <0x03>;
							status = "ok";
						};
					};
				};

				msm_cam_smmu_jpeg {
					compatible = "qcom,msm-cam-smmu-cb";
					iommus = <0xffffffff 0x20c0 0x20 0xffffffff 0x20e0 0x20>;
					cam-smmu-label = "jpeg";
					qcom,iommu-faults = "stall-disable", "HUPCF", "non-fatal";
					stall-disable;
					dma-coherent-hint-cached;
					memory-region = <0x24>;
					phandle = <0x37>;

					iova-mem-map {
						phandle = <0x51>;

						iova-mem-region-io {
							iova-region-name = "io";
							iova-region-start = <0x100000>;
							iova-region-len = <0xffe00000>;
							iova-region-id = <0x03>;
							status = "ok";
						};
					};
				};

				msm_cam_icp_fw {
					compatible = "qcom,msm-cam-smmu-fw-dev";
					label = "icp";
					memory-region = <0xffffffff>;
				};

				msm_cam_smmu_icp {
					compatible = "qcom,msm-cam-smmu-cb";
					iommus = <0xffffffff 0x2000 0x20 0xffffffff 0x2020 0x20 0xffffffff 0x2062 0x00 0xffffffff 0x2080 0x20 0xffffffff 0x20a0 0x20 0xffffffff 0x2140 0x00>;
					cam-smmu-label = "icp";
					qcom,iommu-faults = "stall-disable", "HUPCF", "non-fatal";
					stall-disable;
					dma-coherent-hint-cached;
					iova-region-discard = <0xdff00000 0x300000>;
					memory-region = <0x24>;
					phandle = <0x38>;

					iova-mem-map {
						phandle = <0x52>;

						iova-mem-region-firmware {
							iova-region-name = "firmware";
							iova-region-start = <0x00>;
							iova-region-len = <0x500000>;
							iova-region-id = <0x00>;
							status = "ok";
						};

						iova-mem-region-shared {
							iova-region-name = "shared";
							iova-region-start = "\a@", "";
							iova-region-len = "\t`", "";
							iova-region-id = <0x01>;
							status = "ok";
						};

						iova-mem-region-secondary-heap {
							iova-region-name = "secheap";
							iova-region-start = <0x10a00000>;
							iova-region-len = <0x100000>;
							iova-region-id = <0x04>;
							status = "ok";
						};

						iova-mem-region-io {
							iova-region-name = "io";
							iova-region-start = <0x10c00000>;
							iova-region-len = <0xee300000>;
							iova-region-id = <0x03>;
							iova-region-discard = <0xdff00000 0x300000>;
							status = "ok";
						};

						iova-mem-qdss-region {
							iova-region-name = "qdss";
							iova-region-start = <0x10b00000>;
							iova-region-len = <0x100000>;
							iova-region-id = <0x05>;
							qdss-phy-addr = <0x16790000>;
							status = "ok";
						};
					};
				};

				msm_cam_smmu_cpas_cdm {
					compatible = "qcom,msm-cam-smmu-cb";
					iommus = <0xffffffff 0x2040 0x00>;
					cam-smmu-label = "cpas-cdm";
					qcom,iommu-faults = "stall-disable", "HUPCF", "non-fatal";
					stall-disable;
					dma-coherent-hint-cached;
					memory-region = <0x24>;
					phandle = <0x39>;

					iova-mem-map {
						phandle = <0x53>;

						iova-mem-region-io {
							iova-region-name = "io";
							iova-region-start = <0x100000>;
							iova-region-len = <0xffe00000>;
							iova-region-id = <0x03>;
							status = "ok";
						};
					};
				};

				msm_cam_smmu_secure {
					compatible = "qcom,msm-cam-smmu-cb";
					cam-smmu-label = "cam-secure";
					qcom,secure-cb;
				};

				msm_cam_smmu_lrme {
					compatible = "qcom,msm-cam-smmu-cb";
					iommus = <0xffffffff 0x2100 0x20 0xffffffff 0x2120 0x20>;
					cam-smmu-label = "lrme";
					qcom,iommu-faults = "stall-disable", "HUPCF", "non-fatal";
					stall-disable;
					dma-coherent-hint-cached;
					memory-region = <0x24>;
					phandle = <0x3a>;

					iova-mem-map {
						phandle = <0x54>;

						iova-mem-region-shared {
							iova-region-name = "shared";
							iova-region-start = "\a@", "";
							iova-region-len = <0x6400000>;
							iova-region-id = <0x01>;
							status = "ok";
						};

						iova-mem-region-io {
							iova-region-name = "io";
							iova-region-start = <0x100000>;
							iova-region-len = <0xffe00000>;
							iova-region-id = <0x03>;
							status = "ok";
						};
					};
				};
			};

			qcom,cam-cdm-intf {
				compatible = "qcom,cam-cdm-intf";
				cell-index = <0x00>;
				label = "cam-cdm-intf";
				num-hw-cdm = <0x01>;
				cdm-client-names = "vfe", "jpegdma", "jpegenc", "lrmecdm";
				status = "ok";
			};

			qcom,cpas-cdm0 {
				cell-index = <0x00>;
				compatible = "qcom,cam170-cpas-cdm0";
				label = "cpas-cdm";
				reg = <0xac48000 0x1000>;
				reg-names = "cpas-cdm";
				reg-cam-base = <0x48000>;
				interrupts = <0x00 0x1cd 0x01>;
				interrupt-names = "cpas-cdm";
				regulator-names = "camss";
				camss-supply = <0xffffffff>;
				clock-names = "cam_cc_cpas_slow_ahb_clk", "cam_cc_cpas_ahb_clk";
				clocks = <0xffffffff 0x6a 0xffffffff 0x1e>;
				clock-rates = <0x00 0x00>;
				clock-cntl-level = "svs";
				cdm-client-names = "ife0", "ife1", "ife2", "ife3", "ife4", "dualife";
				status = "ok";
			};

			qcom,cam-isp {
				compatible = "qcom,cam-isp";
				arch-compat = "ife";
				status = "ok";
			};

			qcom,csid0 {
				cell-index = <0x00>;
				compatible = "qcom,csid165_204";
				reg-names = "csid";
				reg = <0xacb3000 0x1000>;
				reg-cam-base = "", "\v0";
				interrupt-names = "csid0";
				interrupts = <0x00 0x1d0 0x01>;
				regulator-names = "camss", "ife0";
				camss-supply = <0xffffffff>;
				ife0-supply = <0xffffffff>;
				clock-names = "ife_csid_clk_src", "ife_csid_clk", "ife_cphy_rx_clk", "ife_clk_src", "ife_clk", "ife_axi_clk";
				clocks = <0xffffffff 0x39 0xffffffff 0x38 0xffffffff 0x37 0xffffffff 0x36 0xffffffff 0x35 0xffffffff 0x34>;
				clock-rates = <0x11e1a300 0x00 0x00 0x16a65700 0x00 0x00 0x17d78400 0x00 0x00 0x1e65fb80 0x00 0x00 0x17d78400 0x00 0x00 0x25f7d940 0x00 0x00 0x17d78400 0x00 0x00 0x2d4cae00 0x00 0x00>;
				clock-cntl-level = "lowsvs", "svs", "svs_l1", "turbo";
				src-clock-name = "ife_csid_clk_src";
				clock-control-debugfs = "true";
				status = "ok";
				phandle = <0x55>;
			};

			qcom,vfe0 {
				cell-index = <0x00>;
				compatible = "qcom,vfe165_160";
				reg-names = "ife";
				reg = <0xacaf000 0x5200>;
				reg-cam-base = <0xaf000>;
				interrupt-names = "ife0";
				interrupts = <0x00 0x1d1 0x01>;
				regulator-names = "camss", "ife0";
				camss-supply = <0xffffffff>;
				ife0-supply = <0xffffffff>;
				clock-names = "ife_clk_src", "ife_clk", "ife_axi_clk";
				clocks = <0xffffffff 0x36 0xffffffff 0x35 0xffffffff 0x34>;
				clock-rates = <0x16a65700 0x00 0x00 0x1e65fb80 0x00 0x00 0x25f7d940 0x00 0x00 0x2d4cae00 0x00 0x00>;
				clock-cntl-level = "lowsvs", "svs", "svs_l1", "turbo";
				src-clock-name = "ife_clk_src";
				clock-control-debugfs = "true";
				clock-names-option = "ife_dsp_clk";
				clocks-option = <0xffffffff 0x3a>;
				clock-rates-option = <0x2d4cae00>;
				cam_hw_pid = <0x18 0x08>;
				status = "ok";
				phandle = <0x56>;
			};

			qcom,csid1 {
				cell-index = <0x01>;
				compatible = "qcom,csid165_204";
				reg-names = "csid";
				reg = <0xacba000 0x1000>;
				reg-cam-base = <0xba000>;
				interrupt-names = "csid1";
				interrupts = <0x00 0x1d2 0x01>;
				regulator-names = "camss", "ife1";
				camss-supply = <0xffffffff>;
				ife1-supply = <0xffffffff>;
				clock-names = "ife_csid_clk_src", "ife_csid_clk", "ife_cphy_rx_clk", "ife_clk_src", "ife_clk", "ife_axi_clk";
				clocks = <0xffffffff 0x40 0xffffffff 0x3f 0xffffffff 0x3e 0xffffffff 0x3d 0xffffffff 0x3c 0xffffffff 0x3b>;
				clock-rates = <0x11e1a300 0x00 0x00 0x16a65700 0x00 0x00 0x17d78400 0x00 0x00 0x1e65fb80 0x00 0x00 0x17d78400 0x00 0x00 0x25f7d940 0x00 0x00 0x17d78400 0x00 0x00 0x2d4cae00 0x00 0x00>;
				clock-cntl-level = "lowsvs", "svs", "svs_l1", "turbo";
				src-clock-name = "ife_csid_clk_src";
				clock-control-debugfs = "true";
				status = "ok";
				phandle = <0x57>;
			};

			qcom,vfe1 {
				cell-index = <0x01>;
				compatible = "qcom,vfe165_160";
				reg-names = "ife";
				reg = <0xacb6000 0x5200>;
				reg-cam-base = "", "\v`";
				interrupt-names = "ife1";
				interrupts = <0x00 0x1d3 0x01>;
				regulator-names = "camss", "ife1";
				camss-supply = <0xffffffff>;
				ife1-supply = <0xffffffff>;
				clock-names = "ife_clk_src", "ife_clk", "ife_axi_clk";
				clocks = <0xffffffff 0x3d 0xffffffff 0x3c 0xffffffff 0x3b>;
				clock-rates = <0x16a65700 0x00 0x00 0x1e65fb80 0x00 0x00 0x25f7d940 0x00 0x00 0x2d4cae00 0x00 0x00>;
				clock-cntl-level = "lowsvs", "svs", "svs_l1", "turbo";
				src-clock-name = "ife_clk_src";
				clock-control-debugfs = "true";
				clock-names-option = "ife_dsp_clk";
				clocks-option = <0xffffffff 0x41>;
				clock-rates-option = <0x2d4cae00>;
				cam_hw_pid = <0x19 0x09>;
				status = "ok";
				phandle = <0x58>;
			};

			qcom,csid2 {
				cell-index = <0x02>;
				compatible = "qcom,csid165_204";
				reg-names = "csid";
				reg = <0xacc1000 0x1000>;
				reg-cam-base = <0xc1000>;
				interrupt-names = "csid2";
				interrupts = <0x00 0x280 0x01>;
				regulator-names = "camss", "ife2";
				camss-supply = <0xffffffff>;
				ife2-supply = <0xffffffff>;
				clock-names = "ife_csid_clk_src", "ife_csid_clk", "ife_cphy_rx_clk", "ife_clk_src", "ife_clk", "ife_axi_clk";
				clocks = <0xffffffff 0x47 0xffffffff 0x46 0xffffffff 0x45 0xffffffff 0x44 0xffffffff 0x43 0xffffffff 0x42>;
				clock-rates = <0x11e1a300 0x00 0x00 0x16a65700 0x00 0x00 0x17d78400 0x00 0x00 0x1e65fb80 0x00 0x00 0x17d78400 0x00 0x00 0x25f7d940 0x00 0x00 0x17d78400 0x00 0x00 0x2d4cae00 0x00 0x00>;
				clock-cntl-level = "lowsvs", "svs", "svs_l1", "turbo";
				src-clock-name = "ife_csid_clk_src";
				clock-control-debugfs = "true";
				status = "ok";
				phandle = <0x59>;
			};

			qcom,vfe2 {
				cell-index = <0x02>;
				compatible = "qcom,vfe165_160";
				reg-names = "ife";
				reg = <0xacbd000 0x5200>;
				reg-cam-base = <0xbd000>;
				interrupt-names = "ife2";
				interrupts = <0x00 0x281 0x01>;
				regulator-names = "camss", "ife2";
				camss-supply = <0xffffffff>;
				ife2-supply = <0xffffffff>;
				clock-names = "ife_clk_src", "ife_clk", "ife_axi_clk";
				clocks = <0xffffffff 0x44 0xffffffff 0x43 0xffffffff 0x42>;
				clock-rates = <0x16a65700 0x00 0x00 0x1e65fb80 0x00 0x00 0x25f7d940 0x00 0x00 0x2d4cae00 0x00 0x00>;
				clock-cntl-level = "lowsvs", "svs", "svs_l1", "turbo";
				src-clock-name = "ife_clk_src";
				clock-control-debugfs = "true";
				clock-names-option = "ife_dsp_clk";
				clocks-option = <0xffffffff 0x48>;
				clock-rates-option = <0x2d4cae00>;
				cam_hw_pid = <0x03 0x0a>;
				status = "ok";
				phandle = <0x5a>;
			};

			qcom,csid-lite0 {
				cell-index = <0x03>;
				compatible = "qcom,csid-lite165";
				reg-names = "csid-lite";
				reg = <0xacc8000 0x1000>;
				reg-cam-base = <0xc8000>;
				interrupt-names = "csid-lite0";
				interrupts = <0x00 0x1d4 0x01>;
				regulator-names = "camss";
				camss-supply = <0xffffffff>;
				clock-names = "ife_csid_clk_src", "ife_csid_clk", "ife_cphy_rx_clk", "ife_clk_src", "ife_clk";
				clocks = <0xffffffff 0x4d 0xffffffff 0x4c 0xffffffff 0x4b 0xffffffff 0x4a 0xffffffff 0x49>;
				clock-rates = <0x11e1a300 0x00 0x00 0x1312d000 0x00 0x17d78400 0x00 0x00 0x17d78400 0x00 0x17d78400 0x00 0x00 0x1c9c3800 0x00 0x17d78400 0x00 0x00 0x23c34600 0x00>;
				clock-cntl-level = "lowsvs", "svs", "svs_l1", "turbo";
				src-clock-name = "ife_csid_clk_src";
				clock-control-debugfs = "true";
				status = "ok";
				phandle = <0x5b>;
			};

			qcom,vfe-lite0 {
				cell-index = <0x03>;
				compatible = "qcom,vfe-lite165";
				reg-names = "ife-lite";
				reg = <0xacc4000 0x5000>;
				reg-cam-base = "", "\f@";
				interrupt-names = "ife-lite0";
				interrupts = <0x00 0x1d5 0x01>;
				regulator-names = "camss";
				camss-supply = <0xffffffff>;
				clock-names = "ife_clk_src", "ife_clk";
				clocks = <0xffffffff 0x4a 0xffffffff 0x49>;
				clock-rates = <0x1312d000 0x00 0x17d78400 0x00 0x1c9c3800 0x00 0x23c34600 0x00>;
				clock-cntl-level = "lowsvs", "svs", "svs_l1", "turbo";
				src-clock-name = "ife_clk_src";
				clock-control-debugfs = "true";
				cam_hw_pid = <0x0b>;
				status = "ok";
				phandle = <0x5c>;
			};

			qcom,csid-lite1 {
				cell-index = <0x04>;
				compatible = "qcom,csid-lite165";
				reg-names = "csid-lite";
				reg = <0xaccf000 0x1000>;
				reg-cam-base = <0xcf000>;
				interrupt-names = "csid-lite1";
				interrupts = <0x00 0x167 0x01>;
				regulator-names = "camss";
				camss-supply = <0xffffffff>;
				clock-names = "ife_csid_clk_src", "ife_csid_clk", "ife_cphy_rx_clk", "ife_clk_src", "ife_clk";
				clocks = <0xffffffff 0x52 0xffffffff 0x51 0xffffffff 0x50 0xffffffff 0x4f 0xffffffff 0x4e>;
				clock-rates = <0x11e1a300 0x00 0x00 0x1312d000 0x00 0x17d78400 0x00 0x00 0x17d78400 0x00 0x17d78400 0x00 0x00 0x1c9c3800 0x00 0x17d78400 0x00 0x00 0x23c34600 0x00>;
				clock-cntl-level = "lowsvs", "svs", "svs_l1", "turbo";
				src-clock-name = "ife_csid_clk_src";
				clock-control-debugfs = "true";
				status = "ok";
				phandle = <0x5d>;
			};

			qcom,vfe-lite1 {
				cell-index = <0x04>;
				compatible = "qcom,vfe-lite165";
				reg-names = "ife-lite";
				reg = <0xaccb000 0x5000>;
				reg-cam-base = <0xcb000>;
				interrupt-names = "ife-lite1";
				interrupts = <0x00 0x168 0x01>;
				regulator-names = "camss";
				camss-supply = <0xffffffff>;
				clock-names = "ife_clk_src", "ife_clk";
				clocks = <0xffffffff 0x4f 0xffffffff 0x4e>;
				clock-rates = <0x1312d000 0x00 0x17d78400 0x00 0x1c9c3800 0x00 0x23c34600 0x00>;
				clock-cntl-level = "lowsvs", "svs", "svs_l1", "turbo";
				src-clock-name = "ife_clk_src";
				clock-control-debugfs = "true";
				cam_hw_pid = <0x0c>;
				status = "ok";
				phandle = <0x5e>;
			};

			qcom,cam-icp {
				compatible = "qcom,cam-icp";
				compat-hw-name = "qcom,a5", "qcom,ipe0", "qcom,bps";
				num-a5 = <0x01>;
				num-ipe = <0x01>;
				num-bps = <0x01>;
				icp_pc_en;
				status = "ok";
			};

			qcom,a5 {
				cell-index = <0x00>;
				compatible = "qcom,cam-a5";
				reg = <0xac00000 0x6000 0xac10000 0x8000 0xac18000 0x3000>;
				reg-names = "a5_qgic", "a5_sierra", "a5_csr";
				reg-cam-base = <0x00 0x10000 0x18000>;
				interrupts = <0x00 0x1cf 0x01>;
				interrupt-names = "a5";
				regulator-names = "camss-vdd";
				camss-vdd-supply = <0xffffffff>;
				clock-names = "soc_fast_ahb", "icp_ahb_clk", "icp_clk_src", "icp_clk";
				src-clock-name = "icp_clk_src";
				clocks = <0xffffffff 0x2f 0xffffffff 0x31 0xffffffff 0x33 0xffffffff 0x32>;
				clock-rates = <0x5f5e100 0x00 0x17d78400 0x00 0xbebc200 0x00 0x17d78400 0x00 0x11e1a300 0x00 0x23c34600 0x00 0x17d78400 0x00 0x23c34600 0x00 0x17d78400 0x00 0x23c34600 0x00>;
				clock-cntl-level = "lowsvs", "svs", "svs_l1", "nominal", "turbo";
				fw_name = "CAMERA_ICP_170.elf";
				ubwc-ipe-fetch-cfg = <0x7073 0x707b>;
				ubwc-ipe-write-cfg = <0x161cf 0x161ef>;
				ubwc-bps-fetch-cfg = <0x7073 0x707b>;
				ubwc-bps-write-cfg = <0x161cf 0x161ef>;
				qos-val = <0xa0a>;
				status = "ok";
				phandle = <0x5f>;
			};

			qcom,ipe0 {
				cell-index = <0x00>;
				compatible = "qcom,cam-ipe";
				reg = <0xac87000 0xa000>;
				reg-names = "ipe0_top";
				reg-cam-base = "", "\bp";
				regulator-names = "ipe0-vdd";
				ipe0-vdd-supply = <0xffffffff>;
				clock-names = "ipe_0_ahb_clk", "ipe_0_areg_clk", "ipe_0_axi_clk", "ipe_0_clk_src", "ipe_0_clk";
				src-clock-name = "ipe_0_clk_src";
				clock-control-debugfs = "true";
				clocks = <0xffffffff 0x53 0xffffffff 0x54 0xffffffff 0x55 0xffffffff 0x57 0xffffffff 0x56>;
				clock-rates = <0x00 0x00 0x00 0x11e1a300 0x00 0x00 0x00 0x00 0x19a14780 0x00 0x00 0x00 0x00 0x1efe9200 0x00 0x00 0x00 0x00 0x23c34600 0x00 0x00 0x00 0x00 0x23c34600 0x00>;
				clock-cntl-level = "lowsvs", "svs", "svs_l1", "nominal", "turbo";
				status = "ok";
				phandle = <0x60>;
			};

			qcom,bps {
				cell-index = <0x00>;
				compatible = "qcom,cam-bps";
				reg = <0xac6f000 0x8000>;
				reg-names = "bps_top";
				reg-cam-base = <0x6f000>;
				regulator-names = "bps-vdd";
				bps-vdd-supply = <0xffffffff>;
				clock-names = "bps_ahb_clk", "bps_areg_clk", "bps_axi_clk", "bps_clk_src", "bps_clk";
				src-clock-name = "bps_clk_src";
				clock-control-debugfs = "true";
				clocks = <0xffffffff 0x11 0xffffffff 0x12 0xffffffff 0x13 0xffffffff 0x15 0xffffffff 0x14>;
				clock-rates = <0x00 0x00 0x00 0xbebc200 0x00 0x00 0x00 0x00 0x17d78400 0x00 0x00 0x00 0x00 0x1c9c3800 0x00 0x00 0x00 0x00 0x23c34600 0x00 0x00 0x00 0x00 0x23c34600 0x00>;
				clock-cntl-level = "lowsvs", "svs", "svs_l1", "nominal", "turbo";
				status = "ok";
				phandle = <0x61>;
			};

			qcom,cam-jpeg {
				compatible = "qcom,cam-jpeg";
				compat-hw-name = "qcom,jpegenc", "qcom,jpegdma";
				num-jpeg-enc = <0x01>;
				num-jpeg-dma = <0x01>;
				status = "ok";
			};

			qcom,jpegenc {
				cell-index = <0x00>;
				compatible = "qcom,cam_jpeg_enc_165";
				reg-names = "jpege_hw", "cam_camnoc";
				reg = <0xac4e000 0x4000 0xac9f000 0x10000>;
				reg-cam-base = <0x4e000 0x9f000>;
				interrupt-names = "jpeg";
				interrupts = <0x00 0x1da 0x01>;
				regulator-names = "camss-vdd";
				camss-vdd-supply = <0xffffffff>;
				clock-names = "jpegenc_clk_src", "jpegenc_clk";
				clocks = <0xffffffff 0x59 0xffffffff 0x58>;
				clock-rates = <0x23c34600 0x00>;
				src-clock-name = "jpegenc_clk_src";
				clock-cntl-level = "nominal";
				cam_hw_pid = <0x16 0x17>;
				cam_hw_rd_mid = <0x00>;
				cam_hw_wr_mid = <0x02>;
				status = "ok";
				phandle = <0x62>;
			};

			qcom,jpegdma {
				cell-index = <0x00>;
				compatible = "qcom,cam_jpeg_dma_165";
				reg-names = "jpegdma_hw", "cam_camnoc";
				reg = <0xac52000 0x4000 0xac9f000 0x10000>;
				reg-cam-base = <0x52000 0x9f000>;
				interrupt-names = "jpegdma";
				interrupts = <0x00 0x1db 0x01>;
				regulator-names = "camss-vdd";
				camss-vdd-supply = <0xffffffff>;
				clock-names = "jpegdma_clk_src", "jpegdma_clk";
				clocks = <0xffffffff 0x59 0xffffffff 0x58>;
				clock-rates = <0x23c34600 0x00>;
				src-clock-name = "jpegdma_clk_src";
				clock-cntl-level = "nominal";
				cam_hw_pid = <0x14 0x15>;
				cam_hw_rd_mid = <0x00>;
				cam_hw_wr_mid = <0x02>;
				status = "ok";
				phandle = <0x63>;
			};

			qcom,cam-lrme {
				compatible = "qcom,cam-lrme";
				arch-compat = "lrme";
				status = "ok";
			};

			qcom,lrme {
				cell-index = <0x00>;
				compatible = "qcom,lrme";
				reg-names = "lrme";
				reg = <0xac6b000 0x1000>;
				reg-cam-base = <0x6b000>;
				interrupt-names = "lrme";
				interrupts = <0x00 0x1dc 0x01>;
				regulator-names = "camss-vdd";
				camss-supply = <0xffffffff>;
				clock-names = "lrme_clk_src", "lrme_clk";
				clocks = <0xffffffff 0x5b 0xffffffff 0x5a>;
				clock-rates = <0xe4e1c00 0xe4e1c00 0x11e1a300 0x11e1a300 0x1312d000 0x1312d000 0x17d78400 0x17d78400 0x17d78400 0x17d78400>;
				clock-cntl-level = "lowsvs", "svs", "svs_l1", "nominal", "turbo";
				src-clock-name = "lrme_clk_src";
				status = "ok";
				phandle = <0x64>;
			};

			qcom,cam-cpas {
				cell-index = <0x00>;
				compatible = "qcom,cam-cpas";
				label = "cpas";
				arch-compat = "cpas_top";
				status = "ok";
				reg-names = "cam_cpas_top", "cam_camnoc";
				reg = <0xac40000 0x1000 0xac9f000 0x10000>;
				reg-cam-base = <0x40000 0x9f000>;
				cam_hw_fuse = <0x04 0x7801fc 0x10 0x00 0x04 0x06 0x7801fc 0x20 0x00 0x10 0x07 0x7801fc 0x40 0x00 0xff 0x00 0x7801fc 0x80 0x00 0xff 0x08 0x7801fc 0x100 0x00 0x10 0x09 0x7801a4 0x10000000 0x00 0xff>;
				interrupt-names = "cpas_camnoc";
				interrupts = <0x00 0x1cb 0x01>;
				camnoc-axi-min-ib-bw = <0xb2d05e00>;
				regulator-names = "camss-vdd";
				camss-vdd-supply = <0xffffffff>;
				clock-names = "gcc_axi_hf_clk", "gcc_axi_sf_clk", "slow_ahb_clk_src", "cpas_ahb_clk", "camnoc_axi_clk_src", "camnoc_axi_clk", "icp_ahb_clk", "icp_clk";
				clocks = <0xffffffff 0x0c 0xffffffff 0x0d 0xffffffff 0x6a 0xffffffff 0x1e 0xffffffff 0x17 0xffffffff 0x16 0xffffffff 0x31 0xffffffff 0x32>;
				src-clock-name = "camnoc_axi_clk_src";
				clock-rates = <0x00 0x00 0x00 0x00 0x00 0x00 0x00 0x00 0x00 0x00 0x4c4b400 0x00 0x8f0d180 0x00 0x00 0x00 0x00 0x00 0x4c4b400 0x00 0xe4e1c00 0x00 0x00 0x00 0x00 0x00 0x4c4b400 0x00 0x1312d000 0x00 0x00 0x00 0x00 0x00 0x4c4b400 0x00 0x17d78400 0x00 0x00 0x00 0x00 0x00 0x4c4b400 0x00 0x1c9c3800 0x00 0x00 0x00>;
				clock-cntl-level = "suspend", "lowsvs", "svs", "svs_l1", "nominal", "turbo";
				control-camnoc-axi-clk;
				camnoc-bus-width = <0x20>;
				camnoc-axi-clk-bw-margin-perc = <0x14>;
				interconnect-names = "cam_ahb";
				interconnects = <0xffffffff 0x02 0xffffffff 0x205>;
				cam-ahb-num-cases = <0x07>;
				cam-ahb-bw-KBps = <0x00 0x00 0x00 0x12c00 0x00 0x249f0 0x00 0x249f0 0x00 0x493e0 0x00 0x493e0 0x00 0x493e0>;
				vdd-corners = <0x10 0x30 0x40 0x80 0xc0 0x100 0x140 0x150 0x180 0x1a0>;
				vdd-corner-ahb-mapping = "suspend", "lowsvs", "lowsvs", "svs", "svs_l1", "nominal", "nominal", "nominal", "turbo", "turbo";
				client-id-based;
				client-names = "csiphy0", "csiphy1", "csiphy2", "csiphy3", "csiphy4", "cci0", "cci1", "csid0", "csid1", "csid2", "csid3", "csid4", "ife0", "ife1", "ife2", "ife3", "ife4", "ipe0", "cam-cdm-intf0", "cpas-cdm0", "bps0", "icp0", "jpeg-dma0", "jpeg-enc0", "lrmecpas0";

				camera-bus-nodes {

					level3-nodes {
						level-index = <0x03>;

						level3-rt0-wr-sum {
							cell-index = <0x00>;
							node-name = "level3-rt0-wr-sum";
							traffic-merge-type = <0x00>;
							ib-bw-voting-needed;
							phandle = <0x25>;

							qcom,axi-port-mnoc {
								interconnect-names = "cam_hf_0";
								interconnects = <0xffffffff 0x22 0xffffffff 0x200>;
							};
						};

						level3-nrt0-rd-wr-sum {
							cell-index = <0x01>;
							node-name = "level3-nrt0-rd-wr-sum";
							traffic-merge-type = <0x00>;
							phandle = <0x26>;

							qcom,axi-port-mnoc {
								interconnect-names = "cam_sf_0";
								interconnects = <0xffffffff 0x24 0xffffffff 0x200>;
							};
						};

						level3-nrt1-rd-sum {
							cell-index = <0x02>;
							node-name = "level3-nrt1-rd-sum";
							traffic-merge-type = <0x00>;
							phandle = <0x27>;

							qcom,axi-port-mnoc {
								interconnect-names = "cam_sf_icp";
								interconnects = <0xffffffff 0x23 0xffffffff 0x200>;
							};
						};
					};

					level2-nodes {
						level-index = <0x03>;
						camnoc-max-needed;

						level2-rt0-write0 {
							cell-index = <0x03>;
							node-name = "level2-rt0-write0";
							parent-node = <0x25>;
							traffic-merge-type = <0x01>;
							phandle = <0x28>;
						};

						level2-rt1-write0 {
							cell-index = <0x04>;
							node-name = "level2-rt1-write0";
							parent-node = <0x25>;
							traffic-merge-type = <0x01>;
							phandle = <0x29>;
						};

						level2-nrt0-write0 {
							cell-index = <0x05>;
							node-name = "level2-nrt0-write0";
							parent-node = <0x26>;
							traffic-merge-type = <0x00>;
							phandle = <0x2a>;
						};

						level2-nrt0-read0 {
							cell-index = <0x06>;
							node-name = "level2-nrt0-read0";
							parent-node = <0x26>;
							traffic-merge-type = <0x00>;
							phandle = <0x2b>;
						};

						level2-nrt1-read0 {
							cell-index = <0x07>;
							node-name = "level2-nrt1-read0";
							parent-node = <0x27>;
							traffic-merge-type = <0x00>;
							bus-width-factor = <0x04>;
							phandle = <0x33>;
						};
					};

					level1-nodes {
						level-index = <0x01>;
						camnoc-max-needed;

						level1-rt0-write0 {
							cell-index = <0x08>;
							node-name = "level1-rt0-write0";
							parent-node = <0x28>;
							traffic-merge-type = <0x00>;
							phandle = <0x2c>;
						};

						level1-rt1-write0 {
							cell-index = <0x09>;
							node-name = "level1-rt1-write0";
							parent-node = <0x29>;
							traffic-merge-type = <0x00>;
							phandle = <0x2d>;
						};

						level1-rt1-write1 {
							cell-index = <0x0a>;
							node-name = "level1-rt1-write1";
							parent-node = <0x29>;
							traffic-merge-type = <0x00>;
							phandle = <0x2e>;
						};

						level1-nrt0-write0 {
							cell-index = <0x0b>;
							node-name = "level1-nrt0-write0";
							parent-node = <0x2a>;
							traffic-merge-type = <0x00>;
							phandle = <0x2f>;
						};

						level1-nrt0-read0 {
							cell-index = <0x0c>;
							node-name = "level1-nrt0-read0";
							parent-node = <0x2b>;
							traffic-merge-type = <0x00>;
							phandle = <0x30>;
						};

						level1-nrt1-write0 {
							cell-index = <0x0d>;
							node-name = "level1-nrt1-write0";
							parent-node = <0x2a>;
							traffic-merge-type = <0x00>;
							phandle = <0x31>;
						};

						level1-nrt1-read0 {
							cell-index = <0x0e>;
							node-name = "level1-nrt1-read0";
							parent-node = <0x2b>;
							traffic-merge-type = <0x00>;
							phandle = <0x32>;
						};
					};

					level0-nodes {
						level-index = <0x00>;

						ife0-rdi-wr {
							cell-index = <0x10>;
							node-name = "ife0-rdi-wr";
							client-name = "ife0";
							traffic-data = <0x105>;
							traffic-transaction-type = <0x01>;
							constituent-paths = <0x04 0x05 0x06 0x07>;
							parent-node = <0x2c>;
							phandle = <0x65>;
						};

						ife1-rdi-wr {
							cell-index = <0x11>;
							node-name = "ife1-rdi-wr";
							client-name = "ife1";
							traffic-data = <0x105>;
							traffic-transaction-type = <0x01>;
							constituent-paths = <0x04 0x05 0x06 0x07>;
							parent-node = <0x2c>;
							phandle = <0x66>;
						};

						ife2-rdi-wr {
							cell-index = <0x12>;
							node-name = "ife2-rdi-wr";
							client-name = "ife2";
							traffic-data = <0x105>;
							traffic-transaction-type = <0x01>;
							constituent-paths = <0x04 0x05 0x06 0x07>;
							parent-node = <0x2c>;
							phandle = <0x67>;
						};

						ife3-rdi-wr {
							cell-index = <0x13>;
							node-name = "ife3-rdi-wr";
							client-name = "ife3";
							traffic-data = <0x105>;
							traffic-transaction-type = <0x01>;
							constituent-paths = <0x04 0x05 0x06 0x07>;
							parent-node = <0x2c>;
							phandle = <0x68>;
						};

						ife4-rdi-wr {
							cell-index = <0x14>;
							node-name = "ife4-rdi-wr";
							client-name = "ife4";
							traffic-data = <0x105>;
							traffic-transaction-type = <0x01>;
							constituent-paths = <0x04 0x05 0x06 0x07>;
							parent-node = <0x2c>;
							phandle = <0x69>;
						};

						ife0-pixelall-wr {
							cell-index = <0x15>;
							node-name = "ife0-pixelall-wr";
							client-name = "ife0";
							traffic-data = <0x103>;
							traffic-transaction-type = <0x01>;
							constituent-paths = <0x00 0x08 0x01 0x02 0x03 0x09>;
							parent-node = <0x2d>;
							phandle = <0x6a>;
						};

						ife1-pixelall-wr {
							cell-index = <0x16>;
							node-name = "ife1-pixelall-wr";
							client-name = "ife1";
							traffic-data = <0x103>;
							traffic-transaction-type = <0x01>;
							constituent-paths = <0x00 0x08 0x01 0x02 0x03 0x09>;
							parent-node = <0x2d>;
							phandle = <0x6b>;
						};

						ife2-pixelall-wr {
							cell-index = <0x17>;
							node-name = "ife2-pixelall-wr";
							client-name = "ife2";
							traffic-data = <0x103>;
							traffic-transaction-type = <0x01>;
							constituent-paths = <0x00 0x08 0x01 0x02 0x03 0x09>;
							parent-node = <0x2e>;
							phandle = <0x6c>;
						};

						ipe0-ref-wr {
							cell-index = <0x18>;
							node-name = "ipe0-ref-wr";
							client-name = "ipe0";
							traffic-data = <0x24>;
							traffic-transaction-type = <0x01>;
							parent-node = <0x2f>;
							phandle = <0x6d>;
						};

						bps0-all-wr {
							cell-index = <0x19>;
							node-name = "bps0-all-wr";
							client-name = "bps0";
							traffic-data = <0x100>;
							traffic-transaction-type = <0x01>;
							parent-node = <0x2f>;
							phandle = <0x6e>;
						};

						lrme0-all-wr {
							cell-index = <0x1a>;
							node-name = "lrme0-all-wr";
							client-name = "lrmecpas0";
							traffic-data = <0x100>;
							traffic-transaction-type = <0x01>;
							parent-node = <0x2f>;
							phandle = <0x6f>;
						};

						ipe0-viddisp-wr {
							cell-index = <0x1b>;
							node-name = "ipe0-viddisp-wr";
							client-name = "ipe0";
							traffic-data = <0x101>;
							traffic-transaction-type = <0x01>;
							constituent-paths = <0x22 0x23>;
							parent-node = <0x2f>;
							phandle = <0x70>;
						};

						ipe0-all-rd {
							cell-index = <0x1c>;
							node-name = "ipe0-all-rd";
							client-name = "ipe0";
							traffic-data = <0x100>;
							traffic-transaction-type = <0x00>;
							constituent-paths = <0x20 0x21>;
							parent-node = <0x30>;
							phandle = <0x71>;
						};

						bps0-all-rd {
							cell-index = <0x1d>;
							node-name = "bps0-all-rd";
							client-name = "bps0";
							traffic-data = <0x100>;
							traffic-transaction-type = <0x00>;
							parent-node = <0x30>;
							phandle = <0x72>;
						};

						lrme0-all-rd {
							cell-index = <0x1e>;
							node-name = "lrme0-all-rd";
							client-name = "lrmecpas0";
							traffic-data = <0x100>;
							traffic-transaction-type = <0x00>;
							parent-node = <0x30>;
							phandle = <0x73>;
						};

						jpeg-enc0-all-wr {
							cell-index = <0x1f>;
							node-name = "jpeg-enc0-all-wr";
							client-name = "jpeg-enc0";
							traffic-data = <0x100>;
							traffic-transaction-type = <0x01>;
							parent-node = <0x31>;
							phandle = <0x74>;
						};

						jpeg-enc0-all-rd {
							cell-index = <0x20>;
							node-name = "jpeg-enc0-all-rd";
							client-name = "jpeg-enc0";
							traffic-data = <0x100>;
							traffic-transaction-type = <0x00>;
							parent-node = <0x32>;
							phandle = <0x75>;
						};

						jpeg-dma0-all-wr {
							cell-index = <0x21>;
							node-name = "jpeg-dma0-all-wr";
							client-name = "jpeg-dma0";
							traffic-data = <0x100>;
							traffic-transaction-type = <0x01>;
							parent-node = <0x31>;
							phandle = <0x76>;
						};

						jpeg-dma0-all-rd {
							cell-index = <0x22>;
							node-name = "jpeg-dma0-all-rd";
							client-name = "jpeg-dma0";
							traffic-data = <0x100>;
							traffic-transaction-type = <0x00>;
							parent-node = <0x32>;
							phandle = <0x77>;
						};

						cpas-cdm0-all-rd {
							cell-index = <0x23>;
							node-name = "cpas-cdm0-all-rd";
							client-name = "cpas-cdm0";
							traffic-data = <0x100>;
							traffic-transaction-type = <0x00>;
							parent-node = <0x2b>;
							phandle = <0x78>;
						};

						icp0-all-rd {
							cell-index = <0x24>;
							node-name = "icp0-all-rd";
							client-name = "icp0";
							traffic-data = <0x100>;
							traffic-transaction-type = <0x00>;
							parent-node = <0x33>;
							phandle = <0x79>;
						};
					};
				};
			};
		};
	};

	fragment@1 {
		target = <0xffffffff>;

		__overlay__ {
			status = "ok";

			s2mpb03_pmic@56 {
				s2mpb03,wakeup;
				reg = <0x56>;
				compatible = "samsung,s2mpb03pmic";
				phandle = <0x7a>;

				regulators {

					s2mpb03-ldo7 {
						regulator-max-microvolt = <0x2ab980>;
						regulator-min-microvolt = <0x2ab980>;
						regulator-name = "CAM0_s2mpb03-l7";
						phandle = <0x09>;
					};

					s2mpb03-ldo6 {
						regulator-max-microvolt = <0x2c4020>;
						regulator-min-microvolt = <0x2c4020>;
						regulator-name = "CAM0_s2mpb03-l6";
						phandle = <0x1f>;
					};

					s2mpb03-ldo5 {
						regulator-max-microvolt = <0x2ab980>;
						regulator-min-microvolt = <0x2ab980>;
						regulator-name = "CAM0_s2mpb03-l5";
						phandle = <0x0a>;
					};

					s2mpb03-ldo4 {
						regulator-max-microvolt = <0x124f80>;
						regulator-min-microvolt = <0x124f80>;
						regulator-name = "CAM0_s2mpb03-l4";
						phandle = <0x15>;
					};

					s2mpb03-ldo3 {
						regulator-max-microvolt = <0x1b7740>;
						regulator-min-microvolt = <0x1b7740>;
						regulator-name = "CAM0_s2mpb03-l3";
						phandle = <0x0b>;
					};

					s2mpb03-ldo2 {
						regulator-max-microvolt = <0x10c8e0>;
						regulator-min-microvolt = <0x10c8e0>;
						regulator-name = "CAM0_s2mpb03-l2";
						phandle = <0x0c>;
					};

					s2mpb03-ldo1 {
						regulator-max-microvolt = <0x100590>;
						regulator-min-microvolt = <0x100590>;
						regulator-name = "CAM0_s2mpb03-l1";
						phandle = <0x20>;
					};
				};
			};
		};
	};

	fragment@2 {
		target = <0xffffffff>;

		__overlay__ {
			status = "ok";

			sm5714-fled {
				timeout = <0xff>;
				factory_current = <0x00>;
				torch-brightness = <0x07>;
				preflash-brightness = <0x07>;
				flash-brightness = <0x0f>;
				torch-en-gpio = <0xffffffff 0x61 0x00>;
				flash-en-gpio = <0xffffffff 0x60 0x00>;
				slave-addr = <0x92>;
				status = "disabled";
				reg = <0x49>;
				compatible = "siliconmitus,sm5714-fled";
			};
		};
	};

	fragment@3 {
		target = <0xffffffff>;

		__overlay__ {
			status = "ok";

			qcom,ois@62 {
				status = "ok";
				gpio-req-tbl-label = "MCU_RESET0", "MCU_VANA", "MCU_BOOT0";
				gpio-req-tbl-flags = <0x00 0x00 0x00>;
				gpio-req-tbl-num = <0x00 0x01 0x02>;
				gpio-custom1 = <0x02>;
				gpio-vana = <0x01>;
				gpio-reset = <0x00>;
				gpios = <0xffffffff 0x2d 0x00 0xffffffff 0x0b 0x00 0xffffffff 0x2e 0x00>;
				gpio-no-mux = <0x00>;
				pinctrl-1 = <0x34>;
				pinctrl-0 = <0x35>;
				pinctrl-names = "cam_default", "cam_suspend";
				qcom,cam-power-seq-delay = <0x01 0x01 0x01 0x0a>;
				qcom,cam-power-seq-cfg-val = <0x01 0x01 0x01 0x01>;
				qcom,cam-power-seq-type = "cam_vana", "cam_vaf", "cam_vio", "cam_reset";
				rgltr-load-current = <0x30d40 0x30d40>;
				rgltr-max-voltage = <0x1b7740 0x2ab980>;
				rgltr-min-voltage = <0x1b7740 0x2ab980>;
				rgltr-cntrl-support;
				regulator-names = "cam_vio", "cam_vaf";
				cam_vaf-supply = <0x09>;
				cam_vio-supply = <0xffffffff>;
				gyro-orientation = <0x00>;
				pole-values = <0x00 0x01 0x00 0x00 0x00 0x00>;
				slave-id = <0x456>;
				slave-addr = <0xc4>;
				reg = <0x51>;
				cell-index = <0x00>;
				compatible = "qcom,ois";
				phandle = <0x0e>;
			};
		};
	};

	fragment@4 {
		target = <0xffffffff>;

		__overlay__ {

			qcom,cam_smmu {
				#address-cells = <0x01>;
				#size-cells = <0x01>;
			};

			cam_iommu_region_partition {
				iommu-addresses = <0x36 0x00 0x100000 0x36 0xfff00000 0x100000 0x37 0x00 0x100000 0x37 0xfff00000 0x100000 0x38 0x00 0x10c00000 0x38 0xfef00000 0x1100000 0x38 0xdff00000 0x300000 0x39 0x00 0x100000 0x39 0xfff00000 0x100000 0x3a 0x00 0xd800000 0x3a 0xfff00000 0x100000>;
				phandle = <0x24>;
			};
		};
	};

	fragment@5 {
		target = <0xffffffff>;

		__overlay__ {

			cam_sensor_suspend_vana0 {
				phandle = <0x03>;

				config {
					drive-strength = <0x02>;
					bias-pull-down;
					pins = "gpio11";
				};

				mux {
					function = "gpio";
					pins = "gpio11";
				};
			};

			cam_sensor_active_vana0 {
				phandle = <0x04>;

				config {
					drive-strength = <0x02>;
					bias-disable;
					pins = "gpio11";
				};

				mux {
					function = "gpio";
					pins = "gpio11";
				};
			};

			cam_sensor_suspend_mclk0 {
				phandle = <0x05>;

				config {
					output-low;
					drive-strength = <0x04>;
					bias-pull-down;
					pins = "gpio64";
				};

				mux {
					function = "cam_mclk";
					pins = "gpio64";
				};
			};

			cam_flash_suspend {
				phandle = <0x06>;

				config {
					output-low;
					drive-strength = <0x02>;
					bias-disable;
					pins = "gpio96", "gpio97";
				};

				mux {
					function = "gpio";
					pins = "gpio96", "gpio97";
				};
			};

			cam_sensor_active_mclk0 {
				phandle = <0x07>;

				config {
					drive-strength = <0x04>;
					bias-disable;
					pins = "gpio64";
				};

				mux {
					function = "cam_mclk";
					pins = "gpio64";
				};
			};

			cam_flash_active {
				phandle = <0x08>;

				config {
					drive-strength = <0x02>;
					bias-disable;
					pins = "gpio96", "gpio97";
				};

				mux {
					function = "gpio";
					pins = "gpio96", "gpio97";
				};
			};

			cam_sensor_suspend_mclk4 {
				phandle = <0x11>;

				config {
					output-low;
					drive-strength = <0x04>;
					bias-pull-down;
					pins = "gpio67";
				};

				mux {
					function = "cam_mclk";
					pins = "gpio67";
				};
			};

			cam_sensor_suspend_vana1 {
				phandle = <0x12>;

				config {
					output-low;
					drive-strength = <0x02>;
					bias-disable;
					pins = "gpio14";
				};

				mux {
					function = "gpio";
					pins = "gpio14";
				};
			};

			cam_sensor_active_mclk4 {
				phandle = <0x13>;

				config {
					drive-strength = <0x04>;
					bias-disable;
					pins = "gpio67";
				};

				mux {
					function = "cam_mclk";
					pins = "gpio67";
				};
			};

			cam_sensor_active_vana1 {
				phandle = <0x14>;

				config {
					drive-strength = <0x02>;
					bias-disable;
					pins = "gpio14";
				};

				mux {
					function = "gpio";
					pins = "gpio14";
				};
			};

			cam_sensor_suspend_mclk1 {
				phandle = <0x16>;

				config {
					output-low;
					drive-strength = <0x04>;
					bias-pull-down;
					pins = "gpio65";
				};

				mux {
					function = "cam_mclk";
					pins = "gpio65";
				};
			};

			cam_sensor_active_mclk1 {
				phandle = <0x17>;

				config {
					drive-strength = <0x04>;
					bias-disable;
					pins = "gpio65";
				};

				mux {
					function = "cam_mclk";
					pins = "gpio65";
				};
			};

			cam_sensor_suspend_mclk2 {
				phandle = <0x18>;

				config {
					output-low;
					drive-strength = <0x04>;
					bias-pull-down;
					pins = "gpio66";
				};

				mux {
					function = "cam_mclk";
					pins = "gpio66";
				};
			};

			cam_sensor_suspend_vana2 {
				phandle = <0x19>;

				config {
					output-low;
					drive-strength = <0x02>;
					bias-disable;
					pins = "gpio15";
				};

				mux {
					function = "gpio";
					pins = "gpio15";
				};
			};

			cam_sensor_active_mclk2 {
				phandle = <0x1a>;

				config {
					drive-strength = <0x04>;
					bias-disable;
					pins = "gpio66";
				};

				mux {
					function = "cam_mclk";
					pins = "gpio66";
				};
			};

			cam_sensor_active_vana2 {
				phandle = <0x1b>;

				config {
					output-high;
					drive-strength = <0x02>;
					bias-disable;
					pins = "gpio15";
				};

				mux {
					function = "gpio";
					pins = "gpio15";
				};
			};

			cam_sensor_suspend_mclk3 {
				phandle = <0x1d>;

				config {
					output-low;
					drive-strength = <0x04>;
					bias-pull-down;
					pins = "gpio68";
				};

				mux {
					function = "cam_mclk";
					pins = "gpio68";
				};
			};

			cam_sensor_active_mclk3 {
				phandle = <0x1e>;

				config {
					drive-strength = <0x04>;
					bias-disable;
					pins = "gpio68";
				};

				mux {
					function = "cam_mclk";
					pins = "gpio68";
				};
			};

			mcu_suspend {
				phandle = <0x34>;

				config {
					output-low;
					drive-strength = <0x02>;
					bias-pull-down;
					pins = "gpio46", "gpio45";
				};

				mux {
					function = "gpio";
					pins = "gpio46", "gpio45";
				};
			};

			mcu_active {
				phandle = <0x35>;

				config {
					drive-strength = <0x02>;
					bias-disable;
					pins = "gpio46", "gpio45";
				};

				mux {
					function = "gpio";
					pins = "gpio46", "gpio45";
				};
			};
		};
	};

	fragment@6 {
		target = <0xffffffff>;

		__overlay__ {

			mux {
				pins = "gpio79";
				function = "gpio";
			};

			config {
				pins = "gpio79";
				bias-disable;
				drive-strength = <0x02>;
			};
		};
	};

	fragment@7 {
		target = <0xffffffff>;

		__overlay__ {

			mux {
				pins = "gpio78";
				function = "gpio";
			};

			config {
				pins = "gpio78";
				bias-disable;
				drive-strength = <0x02>;
			};
		};
	};

	fragment@8 {
		target = <0xffffffff>;

		__overlay__ {

			mux {
				pins = "gpio79";
				function = "gpio";
			};

			config {
				pins = "gpio79";
				bias-pull-down;
				drive-strength = <0x02>;
				output-low;
			};
		};
	};

	fragment@9 {
		target = <0xffffffff>;

		__overlay__ {

			mux {
				pins = "gpio78";
				function = "gpio";
			};

			config {
				pins = "gpio78";
				bias-pull-down;
				drive-strength = <0x02>;
				output-low;
			};
		};
	};

	__symbols__ {
		led_flash_rear = "/fragment@0/__overlay__/qcom,camera-flash@0";
		sm5714_torch0 = "/fragment@0/__overlay__/qcom,torch_0";
		sm5714_flash0 = "/fragment@0/__overlay__/qcom,flash_0";
		cam_csiphy0 = "/fragment@0/__overlay__/qcom,csiphy0";
		cam_csiphy1 = "/fragment@0/__overlay__/qcom,csiphy1";
		cam_csiphy2 = "/fragment@0/__overlay__/qcom,csiphy2";
		cam_csiphy3 = "/fragment@0/__overlay__/qcom,csiphy3";
		cam_csiphy4 = "/fragment@0/__overlay__/qcom,csiphy4";
		cam_cci0 = "/fragment@0/__overlay__/qcom,cci0";
		sensor_rear_wide = "/fragment@0/__overlay__/qcom,cci0/qcom,cam-sensor0";
		i2c_freq_100Khz_cci0 = "/fragment@0/__overlay__/qcom,cci0/qcom,i2c_standard_mode";
		i2c_freq_400Khz_cci0 = "/fragment@0/__overlay__/qcom,cci0/qcom,i2c_fast_mode";
		i2c_freq_custom_cci0 = "/fragment@0/__overlay__/qcom,cci0/qcom,i2c_custom_mode";
		i2c_freq_1Mhz_cci0 = "/fragment@0/__overlay__/qcom,cci0/qcom,i2c_fast_plus_mode";
		cam_cci1 = "/fragment@0/__overlay__/qcom,cci1";
		actuator_rear0 = "/fragment@0/__overlay__/qcom,cci1/qcom,actuator@0xC";
		eeprom4 = "/fragment@0/__overlay__/qcom,cci1/qcom,eeprom@0x3F";
		eeprom3 = "/fragment@0/__overlay__/qcom,cci1/qcom,eeprom@37";
		eeprom2 = "/fragment@0/__overlay__/qcom,cci1/qcom,eeprom@0x2D";
		eeprom1 = "/fragment@0/__overlay__/qcom,cci1/qcom,eeprom@51";
		eeprom0 = "/fragment@0/__overlay__/qcom,cci1/qcom,eeprom@50";
		sensor_rear_macro = "/fragment@0/__overlay__/qcom,cci1/qcom,cam-sensor4";
		sensor_front_full = "/fragment@0/__overlay__/qcom,cci1/qcom,cam-sensor13";
		sensor_front = "/fragment@0/__overlay__/qcom,cci1/qcom,cam-sensor1";
		sensor_rear_uw = "/fragment@0/__overlay__/qcom,cci1/qcom,cam-sensor2";
		sensor_rear_tele = "/fragment@0/__overlay__/qcom,cci1/qcom,cam-sensor3";
		i2c_freq_100Khz_cci1 = "/fragment@0/__overlay__/qcom,cci1/qcom,i2c_standard_mode";
		i2c_freq_400Khz_cci1 = "/fragment@0/__overlay__/qcom,cci1/qcom,i2c_fast_mode";
		i2c_freq_custom_cci1 = "/fragment@0/__overlay__/qcom,cci1/qcom,i2c_custom_mode";
		i2c_freq_1Mhz_cci1 = "/fragment@0/__overlay__/qcom,cci1/qcom,i2c_fast_plus_mode";
		cam_smmu_ife = "/fragment@0/__overlay__/qcom,cam_smmu/msm_cam_smmu_ife";
		ife_iova_mem_map = "/fragment@0/__overlay__/qcom,cam_smmu/msm_cam_smmu_ife/iova-mem-map";
		cam_smmu_jpeg = "/fragment@0/__overlay__/qcom,cam_smmu/msm_cam_smmu_jpeg";
		jpeg_iova_mem_map = "/fragment@0/__overlay__/qcom,cam_smmu/msm_cam_smmu_jpeg/iova-mem-map";
		cam_smmu_icp = "/fragment@0/__overlay__/qcom,cam_smmu/msm_cam_smmu_icp";
		icp_iova_mem_map = "/fragment@0/__overlay__/qcom,cam_smmu/msm_cam_smmu_icp/iova-mem-map";
		cam_smmu_cpas_cdm = "/fragment@0/__overlay__/qcom,cam_smmu/msm_cam_smmu_cpas_cdm";
		cpas_cdm_iova_mem_map = "/fragment@0/__overlay__/qcom,cam_smmu/msm_cam_smmu_cpas_cdm/iova-mem-map";
		cam_smmu_lrme = "/fragment@0/__overlay__/qcom,cam_smmu/msm_cam_smmu_lrme";
		lrme_iova_mem_map = "/fragment@0/__overlay__/qcom,cam_smmu/msm_cam_smmu_lrme/iova-mem-map";
		cam_csid0 = "/fragment@0/__overlay__/qcom,csid0";
		cam_vfe0 = "/fragment@0/__overlay__/qcom,vfe0";
		cam_csid1 = "/fragment@0/__overlay__/qcom,csid1";
		cam_vfe1 = "/fragment@0/__overlay__/qcom,vfe1";
		cam_csid2 = "/fragment@0/__overlay__/qcom,csid2";
		cam_vfe2 = "/fragment@0/__overlay__/qcom,vfe2";
		cam_csid_lite0 = "/fragment@0/__overlay__/qcom,csid-lite0";
		cam_vfe_lite0 = "/fragment@0/__overlay__/qcom,vfe-lite0";
		cam_csid_lite1 = "/fragment@0/__overlay__/qcom,csid-lite1";
		cam_vfe_lite1 = "/fragment@0/__overlay__/qcom,vfe-lite1";
		cam_a5 = "/fragment@0/__overlay__/qcom,a5";
		cam_ipe0 = "/fragment@0/__overlay__/qcom,ipe0";
		cam_bps = "/fragment@0/__overlay__/qcom,bps";
		cam_jpeg_enc = "/fragment@0/__overlay__/qcom,jpegenc";
		cam_jpeg_dma = "/fragment@0/__overlay__/qcom,jpegdma";
		cam_lrme = "/fragment@0/__overlay__/qcom,lrme";
		level3_rt0_wr_sum = "/fragment@0/__overlay__/qcom,cam-cpas/camera-bus-nodes/level3-nodes/level3-rt0-wr-sum";
		level3_nrt0_rd_wr_sum = "/fragment@0/__overlay__/qcom,cam-cpas/camera-bus-nodes/level3-nodes/level3-nrt0-rd-wr-sum";
		level3_nrt1_rd_sum = "/fragment@0/__overlay__/qcom,cam-cpas/camera-bus-nodes/level3-nodes/level3-nrt1-rd-sum";
		level2_rt0_write0 = "/fragment@0/__overlay__/qcom,cam-cpas/camera-bus-nodes/level2-nodes/level2-rt0-write0";
		level2_rt1_write0 = "/fragment@0/__overlay__/qcom,cam-cpas/camera-bus-nodes/level2-nodes/level2-rt1-write0";
		level2_nrt0_write0 = "/fragment@0/__overlay__/qcom,cam-cpas/camera-bus-nodes/level2-nodes/level2-nrt0-write0";
		level2_nrt0_read0 = "/fragment@0/__overlay__/qcom,cam-cpas/camera-bus-nodes/level2-nodes/level2-nrt0-read0";
		level2_nrt1_read0 = "/fragment@0/__overlay__/qcom,cam-cpas/camera-bus-nodes/level2-nodes/level2-nrt1-read0";
		level1_rt0_write0 = "/fragment@0/__overlay__/qcom,cam-cpas/camera-bus-nodes/level1-nodes/level1-rt0-write0";
		level1_rt1_write0 = "/fragment@0/__overlay__/qcom,cam-cpas/camera-bus-nodes/level1-nodes/level1-rt1-write0";
		level1_rt1_write1 = "/fragment@0/__overlay__/qcom,cam-cpas/camera-bus-nodes/level1-nodes/level1-rt1-write1";
		level1_nrt0_write0 = "/fragment@0/__overlay__/qcom,cam-cpas/camera-bus-nodes/level1-nodes/level1-nrt0-write0";
		level1_nrt0_read0 = "/fragment@0/__overlay__/qcom,cam-cpas/camera-bus-nodes/level1-nodes/level1-nrt0-read0";
		level1_nrt1_write0 = "/fragment@0/__overlay__/qcom,cam-cpas/camera-bus-nodes/level1-nodes/level1-nrt1-write0";
		level1_nrt1_read0 = "/fragment@0/__overlay__/qcom,cam-cpas/camera-bus-nodes/level1-nodes/level1-nrt1-read0";
		ife0_rdi_wr = "/fragment@0/__overlay__/qcom,cam-cpas/camera-bus-nodes/level0-nodes/ife0-rdi-wr";
		ife1_rdi_wr = "/fragment@0/__overlay__/qcom,cam-cpas/camera-bus-nodes/level0-nodes/ife1-rdi-wr";
		ife2_rdi_wr = "/fragment@0/__overlay__/qcom,cam-cpas/camera-bus-nodes/level0-nodes/ife2-rdi-wr";
		ife3_rdi_wr = "/fragment@0/__overlay__/qcom,cam-cpas/camera-bus-nodes/level0-nodes/ife3-rdi-wr";
		ife4_rdi_wr = "/fragment@0/__overlay__/qcom,cam-cpas/camera-bus-nodes/level0-nodes/ife4-rdi-wr";
		ife0_pixelall_wr = "/fragment@0/__overlay__/qcom,cam-cpas/camera-bus-nodes/level0-nodes/ife0-pixelall-wr";
		ife1_pixelall_wr = "/fragment@0/__overlay__/qcom,cam-cpas/camera-bus-nodes/level0-nodes/ife1-pixelall-wr";
		ife2_pixelall_wr = "/fragment@0/__overlay__/qcom,cam-cpas/camera-bus-nodes/level0-nodes/ife2-pixelall-wr";
		ipe0_ref_wr = "/fragment@0/__overlay__/qcom,cam-cpas/camera-bus-nodes/level0-nodes/ipe0-ref-wr";
		bps0_all_wr = "/fragment@0/__overlay__/qcom,cam-cpas/camera-bus-nodes/level0-nodes/bps0-all-wr";
		lrme0_all_wr = "/fragment@0/__overlay__/qcom,cam-cpas/camera-bus-nodes/level0-nodes/lrme0-all-wr";
		ipe0_viddisp_wr = "/fragment@0/__overlay__/qcom,cam-cpas/camera-bus-nodes/level0-nodes/ipe0-viddisp-wr";
		ipe0_all_rd = "/fragment@0/__overlay__/qcom,cam-cpas/camera-bus-nodes/level0-nodes/ipe0-all-rd";
		bps0_all_rd = "/fragment@0/__overlay__/qcom,cam-cpas/camera-bus-nodes/level0-nodes/bps0-all-rd";
		lrme0_all_rd = "/fragment@0/__overlay__/qcom,cam-cpas/camera-bus-nodes/level0-nodes/lrme0-all-rd";
		jpeg_enc0_all_wr = "/fragment@0/__overlay__/qcom,cam-cpas/camera-bus-nodes/level0-nodes/jpeg-enc0-all-wr";
		jpeg_enc0_all_rd = "/fragment@0/__overlay__/qcom,cam-cpas/camera-bus-nodes/level0-nodes/jpeg-enc0-all-rd";
		jpeg_dma0_all_wr = "/fragment@0/__overlay__/qcom,cam-cpas/camera-bus-nodes/level0-nodes/jpeg-dma0-all-wr";
		jpeg_dma0_all_rd = "/fragment@0/__overlay__/qcom,cam-cpas/camera-bus-nodes/level0-nodes/jpeg-dma0-all-rd";
		cpas_cdm0_all_rd = "/fragment@0/__overlay__/qcom,cam-cpas/camera-bus-nodes/level0-nodes/cpas-cdm0-all-rd";
		icp0_all_rd = "/fragment@0/__overlay__/qcom,cam-cpas/camera-bus-nodes/level0-nodes/icp0-all-rd";
		s2mpb03_pmic_0 = "/fragment@1/__overlay__/s2mpb03_pmic@56";
		s2mpb03_0_l7 = "/fragment@1/__overlay__/s2mpb03_pmic@56/regulators/s2mpb03-ldo7";
		s2mpb03_0_l6 = "/fragment@1/__overlay__/s2mpb03_pmic@56/regulators/s2mpb03-ldo6";
		s2mpb03_0_l5 = "/fragment@1/__overlay__/s2mpb03_pmic@56/regulators/s2mpb03-ldo5";
		s2mpb03_0_l4 = "/fragment@1/__overlay__/s2mpb03_pmic@56/regulators/s2mpb03-ldo4";
		s2mpb03_0_l3 = "/fragment@1/__overlay__/s2mpb03_pmic@56/regulators/s2mpb03-ldo3";
		s2mpb03_0_l2 = "/fragment@1/__overlay__/s2mpb03_pmic@56/regulators/s2mpb03-ldo2";
		s2mpb03_0_l1 = "/fragment@1/__overlay__/s2mpb03_pmic@56/regulators/s2mpb03-ldo1";
		ois_rear = "/fragment@3/__overlay__/qcom,ois@62";
		cam_iova = "/fragment@4/__overlay__/cam_iommu_region_partition";
		cam_sensor_suspend_vana0 = "/fragment@5/__overlay__/cam_sensor_suspend_vana0";
		cam_sensor_active_vana0 = "/fragment@5/__overlay__/cam_sensor_active_vana0";
		cam_sensor_suspend_mclk0 = "/fragment@5/__overlay__/cam_sensor_suspend_mclk0";
		cam_flash_suspend = "/fragment@5/__overlay__/cam_flash_suspend";
		cam_sensor_active_mclk0 = "/fragment@5/__overlay__/cam_sensor_active_mclk0";
		cam_flash_active = "/fragment@5/__overlay__/cam_flash_active";
		cam_sensor_suspend_mclk4 = "/fragment@5/__overlay__/cam_sensor_suspend_mclk4";
		cam_sensor_suspend_vana1 = "/fragment@5/__overlay__/cam_sensor_suspend_vana1";
		cam_sensor_active_mclk4 = "/fragment@5/__overlay__/cam_sensor_active_mclk4";
		cam_sensor_active_vana1 = "/fragment@5/__overlay__/cam_sensor_active_vana1";
		cam_sensor_suspend_mclk1 = "/fragment@5/__overlay__/cam_sensor_suspend_mclk1";
		cam_sensor_active_mclk1 = "/fragment@5/__overlay__/cam_sensor_active_mclk1";
		cam_sensor_suspend_mclk2 = "/fragment@5/__overlay__/cam_sensor_suspend_mclk2";
		cam_sensor_suspend_vana2 = "/fragment@5/__overlay__/cam_sensor_suspend_vana2";
		cam_sensor_active_mclk2 = "/fragment@5/__overlay__/cam_sensor_active_mclk2";
		cam_sensor_active_vana2 = "/fragment@5/__overlay__/cam_sensor_active_vana2";
		cam_sensor_suspend_mclk3 = "/fragment@5/__overlay__/cam_sensor_suspend_mclk3";
		cam_sensor_active_mclk3 = "/fragment@5/__overlay__/cam_sensor_active_mclk3";
		mcu_suspend = "/fragment@5/__overlay__/mcu_suspend";
		mcu_active = "/fragment@5/__overlay__/mcu_active";
	};

	__fixups__ {
		soc = "/fragment@0:target:0", "/fragment@4:target:0";
		cam_cc_titan_top_gdsc = "/fragment@0/__overlay__/qcom,csiphy0:gdscr-supply:0", "/fragment@0/__overlay__/qcom,csiphy1:gdscr-supply:0", "/fragment@0/__overlay__/qcom,csiphy2:gdscr-supply:0", "/fragment@0/__overlay__/qcom,csiphy3:gdscr-supply:0", "/fragment@0/__overlay__/qcom,csiphy4:gdscr-supply:0", "/fragment@0/__overlay__/qcom,cci0:gdscr-supply:0", "/fragment@0/__overlay__/qcom,cci0/qcom,cam-sensor0:cam_clk-supply:0", "/fragment@0/__overlay__/qcom,cci1:gdscr-supply:0", "/fragment@0/__overlay__/qcom,cci1/qcom,eeprom@0x3F:cam_clk-supply:0", "/fragment@0/__overlay__/qcom,cci1/qcom,eeprom@37:cam_clk-supply:0", "/fragment@0/__overlay__/qcom,cci1/qcom,eeprom@0x2D:cam_clk-supply:0", "/fragment@0/__overlay__/qcom,cci1/qcom,cam-sensor4:cam_clk-supply:0", "/fragment@0/__overlay__/qcom,cci1/qcom,cam-sensor13:cam_clk-supply:0", "/fragment@0/__overlay__/qcom,cci1/qcom,cam-sensor1:cam_clk-supply:0", "/fragment@0/__overlay__/qcom,cci1/qcom,cam-sensor2:cam_clk-supply:0", "/fragment@0/__overlay__/qcom,cci1/qcom,cam-sensor3:cam_clk-supply:0", "/fragment@0/__overlay__/qcom,cpas-cdm0:camss-supply:0", "/fragment@0/__overlay__/qcom,csid0:camss-supply:0", "/fragment@0/__overlay__/qcom,vfe0:camss-supply:0", "/fragment@0/__overlay__/qcom,csid1:camss-supply:0", "/fragment@0/__overlay__/qcom,vfe1:camss-supply:0", "/fragment@0/__overlay__/qcom,csid2:camss-supply:0", "/fragment@0/__overlay__/qcom,vfe2:camss-supply:0", "/fragment@0/__overlay__/qcom,csid-lite0:camss-supply:0", "/fragment@0/__overlay__/qcom,vfe-lite0:camss-supply:0", "/fragment@0/__overlay__/qcom,csid-lite1:camss-supply:0", "/fragment@0/__overlay__/qcom,vfe-lite1:camss-supply:0", "/fragment@0/__overlay__/qcom,a5:camss-vdd-supply:0", "/fragment@0/__overlay__/qcom,jpegenc:camss-vdd-supply:0", "/fragment@0/__overlay__/qcom,jpegdma:camss-vdd-supply:0", "/fragment@0/__overlay__/qcom,lrme:camss-supply:0", "/fragment@0/__overlay__/qcom,cam-cpas:camss-vdd-supply:0";
		refgen = "/fragment@0/__overlay__/qcom,csiphy0:refgen-supply:0", "/fragment@0/__overlay__/qcom,csiphy1:refgen-supply:0", "/fragment@0/__overlay__/qcom,csiphy2:refgen-supply:0", "/fragment@0/__overlay__/qcom,csiphy3:refgen-supply:0", "/fragment@0/__overlay__/qcom,csiphy4:refgen-supply:0";
		pm7325_l6 = "/fragment@0/__overlay__/qcom,csiphy0:csi-vdd-1p2-supply:0", "/fragment@0/__overlay__/qcom,csiphy1:csi-vdd-1p2-supply:0", "/fragment@0/__overlay__/qcom,csiphy2:csi-vdd-1p2-supply:0", "/fragment@0/__overlay__/qcom,csiphy3:csi-vdd-1p2-supply:0", "/fragment@0/__overlay__/qcom,csiphy4:csi-vdd-1p2-supply:0";
		pm8350c_l10 = "/fragment@0/__overlay__/qcom,csiphy0:csi-vdd-0p9-supply:0", "/fragment@0/__overlay__/qcom,csiphy1:csi-vdd-0p9-supply:0", "/fragment@0/__overlay__/qcom,csiphy2:csi-vdd-0p9-supply:0", "/fragment@0/__overlay__/qcom,csiphy3:csi-vdd-0p9-supply:0", "/fragment@0/__overlay__/qcom,csiphy4:csi-vdd-0p9-supply:0";
		camcc = "/fragment@0/__overlay__/qcom,csiphy0:clocks:0", "/fragment@0/__overlay__/qcom,csiphy0:clocks:8", "/fragment@0/__overlay__/qcom,csiphy0:clocks:16", "/fragment@0/__overlay__/qcom,csiphy0:clocks:24", "/fragment@0/__overlay__/qcom,csiphy1:clocks:0", "/fragment@0/__overlay__/qcom,csiphy1:clocks:8", "/fragment@0/__overlay__/qcom,csiphy1:clocks:16", "/fragment@0/__overlay__/qcom,csiphy1:clocks:24", "/fragment@0/__overlay__/qcom,csiphy2:clocks:0", "/fragment@0/__overlay__/qcom,csiphy2:clocks:8", "/fragment@0/__overlay__/qcom,csiphy2:clocks:16", "/fragment@0/__overlay__/qcom,csiphy2:clocks:24", "/fragment@0/__overlay__/qcom,csiphy3:clocks:0", "/fragment@0/__overlay__/qcom,csiphy3:clocks:8", "/fragment@0/__overlay__/qcom,csiphy3:clocks:16", "/fragment@0/__overlay__/qcom,csiphy3:clocks:24", "/fragment@0/__overlay__/qcom,csiphy4:clocks:0", "/fragment@0/__overlay__/qcom,csiphy4:clocks:8", "/fragment@0/__overlay__/qcom,csiphy4:clocks:16", "/fragment@0/__overlay__/qcom,csiphy4:clocks:24", "/fragment@0/__overlay__/qcom,cci0:clocks:0", "/fragment@0/__overlay__/qcom,cci0:clocks:8", "/fragment@0/__overlay__/qcom,cci0/qcom,cam-sensor0:clocks:0", "/fragment@0/__overlay__/qcom,cci1:clocks:0", "/fragment@0/__overlay__/qcom,cci1:clocks:8", "/fragment@0/__overlay__/qcom,cci1/qcom,eeprom@0x3F:clocks:0", "/fragment@0/__overlay__/qcom,cci1/qcom,eeprom@37:clocks:0", "/fragment@0/__overlay__/qcom,cci1/qcom,eeprom@0x2D:clocks:0", "/fragment@0/__overlay__/qcom,cci1/qcom,cam-sensor4:clocks:0", "/fragment@0/__overlay__/qcom,cci1/qcom,cam-sensor13:clocks:0", "/fragment@0/__overlay__/qcom,cci1/qcom,cam-sensor1:clocks:0", "/fragment@0/__overlay__/qcom,cci1/qcom,cam-sensor2:clocks:0", "/fragment@0/__overlay__/qcom,cci1/qcom,cam-sensor3:clocks:0", "/fragment@0/__overlay__/qcom,cpas-cdm0:clocks:0", "/fragment@0/__overlay__/qcom,cpas-cdm0:clocks:8", "/fragment@0/__overlay__/qcom,csid0:clocks:0", "/fragment@0/__overlay__/qcom,csid0:clocks:8", "/fragment@0/__overlay__/qcom,csid0:clocks:16", "/fragment@0/__overlay__/qcom,csid0:clocks:24", "/fragment@0/__overlay__/qcom,csid0:clocks:32", "/fragment@0/__overlay__/qcom,csid0:clocks:40", "/fragment@0/__overlay__/qcom,vfe0:clocks:0", "/fragment@0/__overlay__/qcom,vfe0:clocks:8", "/fragment@0/__overlay__/qcom,vfe0:clocks:16", "/fragment@0/__overlay__/qcom,vfe0:clocks-option:0", "/fragment@0/__overlay__/qcom,csid1:clocks:0", "/fragment@0/__overlay__/qcom,csid1:clocks:8", "/fragment@0/__overlay__/qcom,csid1:clocks:16", "/fragment@0/__overlay__/qcom,csid1:clocks:24", "/fragment@0/__overlay__/qcom,csid1:clocks:32", "/fragment@0/__overlay__/qcom,csid1:clocks:40", "/fragment@0/__overlay__/qcom,vfe1:clocks:0", "/fragment@0/__overlay__/qcom,vfe1:clocks:8", "/fragment@0/__overlay__/qcom,vfe1:clocks:16", "/fragment@0/__overlay__/qcom,vfe1:clocks-option:0", "/fragment@0/__overlay__/qcom,csid2:clocks:0", "/fragment@0/__overlay__/qcom,csid2:clocks:8", "/fragment@0/__overlay__/qcom,csid2:clocks:16", "/fragment@0/__overlay__/qcom,csid2:clocks:24", "/fragment@0/__overlay__/qcom,csid2:clocks:32", "/fragment@0/__overlay__/qcom,csid2:clocks:40", "/fragment@0/__overlay__/qcom,vfe2:clocks:0", "/fragment@0/__overlay__/qcom,vfe2:clocks:8", "/fragment@0/__overlay__/qcom,vfe2:clocks:16", "/fragment@0/__overlay__/qcom,vfe2:clocks-option:0", "/fragment@0/__overlay__/qcom,csid-lite0:clocks:0", "/fragment@0/__overlay__/qcom,csid-lite0:clocks:8", "/fragment@0/__overlay__/qcom,csid-lite0:clocks:16", "/fragment@0/__overlay__/qcom,csid-lite0:clocks:24", "/fragment@0/__overlay__/qcom,csid-lite0:clocks:32", "/fragment@0/__overlay__/qcom,vfe-lite0:clocks:0", "/fragment@0/__overlay__/qcom,vfe-lite0:clocks:8", "/fragment@0/__overlay__/qcom,csid-lite1:clocks:0", "/fragment@0/__overlay__/qcom,csid-lite1:clocks:8", "/fragment@0/__overlay__/qcom,csid-lite1:clocks:16", "/fragment@0/__overlay__/qcom,csid-lite1:clocks:24", "/fragment@0/__overlay__/qcom,csid-lite1:clocks:32", "/fragment@0/__overlay__/qcom,vfe-lite1:clocks:0", "/fragment@0/__overlay__/qcom,vfe-lite1:clocks:8", "/fragment@0/__overlay__/qcom,a5:clocks:0", "/fragment@0/__overlay__/qcom,a5:clocks:8", "/fragment@0/__overlay__/qcom,a5:clocks:16", "/fragment@0/__overlay__/qcom,a5:clocks:24", "/fragment@0/__overlay__/qcom,ipe0:clocks:0", "/fragment@0/__overlay__/qcom,ipe0:clocks:8", "/fragment@0/__overlay__/qcom,ipe0:clocks:16", "/fragment@0/__overlay__/qcom,ipe0:clocks:24", "/fragment@0/__overlay__/qcom,ipe0:clocks:32", "/fragment@0/__overlay__/qcom,bps:clocks:0", "/fragment@0/__overlay__/qcom,bps:clocks:8", "/fragment@0/__overlay__/qcom,bps:clocks:16", "/fragment@0/__overlay__/qcom,bps:clocks:24", "/fragment@0/__overlay__/qcom,bps:clocks:32", "/fragment@0/__overlay__/qcom,jpegenc:clocks:0", "/fragment@0/__overlay__/qcom,jpegenc:clocks:8", "/fragment@0/__overlay__/qcom,jpegdma:clocks:0", "/fragment@0/__overlay__/qcom,jpegdma:clocks:8", "/fragment@0/__overlay__/qcom,lrme:clocks:0", "/fragment@0/__overlay__/qcom,lrme:clocks:8", "/fragment@0/__overlay__/qcom,cam-cpas:clocks:16", "/fragment@0/__overlay__/qcom,cam-cpas:clocks:24", "/fragment@0/__overlay__/qcom,cam-cpas:clocks:32", "/fragment@0/__overlay__/qcom,cam-cpas:clocks:40", "/fragment@0/__overlay__/qcom,cam-cpas:clocks:48", "/fragment@0/__overlay__/qcom,cam-cpas:clocks:56";
		cci0_active = "/fragment@0/__overlay__/qcom,cci0:pinctrl-0:0";
		cci1_active = "/fragment@0/__overlay__/qcom,cci0:pinctrl-0:4";
		cci0_suspend = "/fragment@0/__overlay__/qcom,cci0:pinctrl-1:0";
		cci1_suspend = "/fragment@0/__overlay__/qcom,cci0:pinctrl-1:4";
		tlmm = "/fragment@0/__overlay__/qcom,cci0:gpios:0", "/fragment@0/__overlay__/qcom,cci0:gpios:12", "/fragment@0/__overlay__/qcom,cci0:gpios:24", "/fragment@0/__overlay__/qcom,cci0:gpios:36", "/fragment@0/__overlay__/qcom,cci0/qcom,cam-sensor0:gpios:0", "/fragment@0/__overlay__/qcom,cci0/qcom,cam-sensor0:gpios:12", "/fragment@0/__overlay__/qcom,cci0/qcom,cam-sensor0:gpios:24", "/fragment@0/__overlay__/qcom,cci1:gpios:0", "/fragment@0/__overlay__/qcom,cci1:gpios:12", "/fragment@0/__overlay__/qcom,cci1:gpios:24", "/fragment@0/__overlay__/qcom,cci1:gpios:36", "/fragment@0/__overlay__/qcom,cci1/qcom,eeprom@0x3F:gpios:0", "/fragment@0/__overlay__/qcom,cci1/qcom,eeprom@0x3F:gpios:12", "/fragment@0/__overlay__/qcom,cci1/qcom,eeprom@0x3F:gpios:24", "/fragment@0/__overlay__/qcom,cci1/qcom,eeprom@37:gpios:0", "/fragment@0/__overlay__/qcom,cci1/qcom,eeprom@37:gpios:12", "/fragment@0/__overlay__/qcom,cci1/qcom,eeprom@37:gpios:24", "/fragment@0/__overlay__/qcom,cci1/qcom,eeprom@0x2D:gpios:0", "/fragment@0/__overlay__/qcom,cci1/qcom,eeprom@0x2D:gpios:12", "/fragment@0/__overlay__/qcom,cci1/qcom,eeprom@0x2D:gpios:24", "/fragment@0/__overlay__/qcom,cci1/qcom,cam-sensor4:gpios:0", "/fragment@0/__overlay__/qcom,cci1/qcom,cam-sensor4:gpios:12", "/fragment@0/__overlay__/qcom,cci1/qcom,cam-sensor4:gpios:24", "/fragment@0/__overlay__/qcom,cci1/qcom,cam-sensor13:gpios:0", "/fragment@0/__overlay__/qcom,cci1/qcom,cam-sensor13:gpios:12", "/fragment@0/__overlay__/qcom,cci1/qcom,cam-sensor1:gpios:0", "/fragment@0/__overlay__/qcom,cci1/qcom,cam-sensor1:gpios:12", "/fragment@0/__overlay__/qcom,cci1/qcom,cam-sensor2:gpios:0", "/fragment@0/__overlay__/qcom,cci1/qcom,cam-sensor2:gpios:12", "/fragment@0/__overlay__/qcom,cci1/qcom,cam-sensor2:gpios:24", "/fragment@0/__overlay__/qcom,cci1/qcom,cam-sensor3:gpios:0", "/fragment@0/__overlay__/qcom,cci1/qcom,cam-sensor3:gpios:12", "/fragment@0/__overlay__/qcom,cci1/qcom,cam-sensor3:gpios:24", "/fragment@2/__overlay__/sm5714-fled:torch-en-gpio:0", "/fragment@2/__overlay__/sm5714-fled:flash-en-gpio:0", "/fragment@3/__overlay__/qcom,ois@62:gpios:0", "/fragment@3/__overlay__/qcom,ois@62:gpios:12", "/fragment@3/__overlay__/qcom,ois@62:gpios:24", "/fragment@5:target:0";
		cam_sensor_suspend_rst0 = "/fragment@0/__overlay__/qcom,cci0/qcom,cam-sensor0:pinctrl-1:4";
		cam_sensor_active_rst0 = "/fragment@0/__overlay__/qcom,cci0/qcom,cam-sensor0:pinctrl-0:4";
		cci2_active = "/fragment@0/__overlay__/qcom,cci1:pinctrl-0:0";
		cci3_active = "/fragment@0/__overlay__/qcom,cci1:pinctrl-0:4";
		cci2_suspend = "/fragment@0/__overlay__/qcom,cci1:pinctrl-1:0";
		cci3_suspend = "/fragment@0/__overlay__/qcom,cci1:pinctrl-1:4";
		cam_sensor_suspend_rst4 = "/fragment@0/__overlay__/qcom,cci1/qcom,eeprom@0x3F:pinctrl-1:4", "/fragment@0/__overlay__/qcom,cci1/qcom,cam-sensor4:pinctrl-1:4", "/fragment@9:target:0";
		cam_sensor_active_rst4 = "/fragment@0/__overlay__/qcom,cci1/qcom,eeprom@0x3F:pinctrl-0:4", "/fragment@0/__overlay__/qcom,cci1/qcom,cam-sensor4:pinctrl-0:4", "/fragment@7:target:0";
		cam_sensor_suspend_rst1 = "/fragment@0/__overlay__/qcom,cci1/qcom,eeprom@37:pinctrl-1:4", "/fragment@0/__overlay__/qcom,cci1/qcom,cam-sensor3:pinctrl-1:4";
		cam_sensor_active_rst1 = "/fragment@0/__overlay__/qcom,cci1/qcom,eeprom@37:pinctrl-0:4", "/fragment@0/__overlay__/qcom,cci1/qcom,cam-sensor3:pinctrl-0:4";
		cam_sensor_suspend_rst2 = "/fragment@0/__overlay__/qcom,cci1/qcom,eeprom@0x2D:pinctrl-1:4", "/fragment@0/__overlay__/qcom,cci1/qcom,cam-sensor2:pinctrl-1:4";
		cam_sensor_active_rst2 = "/fragment@0/__overlay__/qcom,cci1/qcom,eeprom@0x2D:pinctrl-0:4", "/fragment@0/__overlay__/qcom,cci1/qcom,cam-sensor2:pinctrl-0:4";
		cam_sensor_suspend_rst3 = "/fragment@0/__overlay__/qcom,cci1/qcom,cam-sensor13:pinctrl-1:4", "/fragment@0/__overlay__/qcom,cci1/qcom,cam-sensor1:pinctrl-1:4", "/fragment@8:target:0";
		cam_sensor_active_rst3 = "/fragment@0/__overlay__/qcom,cci1/qcom,cam-sensor13:pinctrl-0:4", "/fragment@0/__overlay__/qcom,cci1/qcom,cam-sensor1:pinctrl-0:4", "/fragment@6:target:0";
		apps_smmu = "/fragment@0/__overlay__/qcom,cam_smmu/msm_cam_smmu_ife:iommus:0", "/fragment@0/__overlay__/qcom,cam_smmu/msm_cam_smmu_ife:iommus:12", "/fragment@0/__overlay__/qcom,cam_smmu/msm_cam_smmu_ife:iommus:24", "/fragment@0/__overlay__/qcom,cam_smmu/msm_cam_smmu_ife:iommus:36", "/fragment@0/__overlay__/qcom,cam_smmu/msm_cam_smmu_ife:iommus:48", "/fragment@0/__overlay__/qcom,cam_smmu/msm_cam_smmu_ife:iommus:60", "/fragment@0/__overlay__/qcom,cam_smmu/msm_cam_smmu_ife:iommus:72", "/fragment@0/__overlay__/qcom,cam_smmu/msm_cam_smmu_ife:iommus:84", "/fragment@0/__overlay__/qcom,cam_smmu/msm_cam_smmu_ife:iommus:96", "/fragment@0/__overlay__/qcom,cam_smmu/msm_cam_smmu_ife:iommus:108", "/fragment@0/__overlay__/qcom,cam_smmu/msm_cam_smmu_ife:iommus:120", "/fragment@0/__overlay__/qcom,cam_smmu/msm_cam_smmu_ife:iommus:132", "/fragment@0/__overlay__/qcom,cam_smmu/msm_cam_smmu_ife:iommus:144", "/fragment@0/__overlay__/qcom,cam_smmu/msm_cam_smmu_ife:iommus:156", "/fragment@0/__overlay__/qcom,cam_smmu/msm_cam_smmu_ife:iommus:168", "/fragment@0/__overlay__/qcom,cam_smmu/msm_cam_smmu_ife:iommus:180", "/fragment@0/__overlay__/qcom,cam_smmu/msm_cam_smmu_jpeg:iommus:0", "/fragment@0/__overlay__/qcom,cam_smmu/msm_cam_smmu_jpeg:iommus:12", "/fragment@0/__overlay__/qcom,cam_smmu/msm_cam_smmu_icp:iommus:0", "/fragment@0/__overlay__/qcom,cam_smmu/msm_cam_smmu_icp:iommus:12", "/fragment@0/__overlay__/qcom,cam_smmu/msm_cam_smmu_icp:iommus:24", "/fragment@0/__overlay__/qcom,cam_smmu/msm_cam_smmu_icp:iommus:36", "/fragment@0/__overlay__/qcom,cam_smmu/msm_cam_smmu_icp:iommus:48", "/fragment@0/__overlay__/qcom,cam_smmu/msm_cam_smmu_icp:iommus:60", "/fragment@0/__overlay__/qcom,cam_smmu/msm_cam_smmu_cpas_cdm:iommus:0", "/fragment@0/__overlay__/qcom,cam_smmu/msm_cam_smmu_lrme:iommus:0", "/fragment@0/__overlay__/qcom,cam_smmu/msm_cam_smmu_lrme:iommus:12";
		pil_camera_mem = "/fragment@0/__overlay__/qcom,cam_smmu/msm_cam_icp_fw:memory-region:0";
		cam_cc_ife_0_gdsc = "/fragment@0/__overlay__/qcom,csid0:ife0-supply:0", "/fragment@0/__overlay__/qcom,vfe0:ife0-supply:0";
		cam_cc_ife_1_gdsc = "/fragment@0/__overlay__/qcom,csid1:ife1-supply:0", "/fragment@0/__overlay__/qcom,vfe1:ife1-supply:0";
		cam_cc_ife_2_gdsc = "/fragment@0/__overlay__/qcom,csid2:ife2-supply:0", "/fragment@0/__overlay__/qcom,vfe2:ife2-supply:0";
		cam_cc_ipe_0_gdsc = "/fragment@0/__overlay__/qcom,ipe0:ipe0-vdd-supply:0";
		cam_cc_bps_gdsc = "/fragment@0/__overlay__/qcom,bps:bps-vdd-supply:0";
		gcc = "/fragment@0/__overlay__/qcom,cam-cpas:clocks:0", "/fragment@0/__overlay__/qcom,cam-cpas:clocks:8";
		gem_noc = "/fragment@0/__overlay__/qcom,cam-cpas:interconnects:0";
		cnoc2 = "/fragment@0/__overlay__/qcom,cam-cpas:interconnects:8";
		mmss_noc = "/fragment@0/__overlay__/qcom,cam-cpas/camera-bus-nodes/level3-nodes/level3-rt0-wr-sum/qcom,axi-port-mnoc:interconnects:0", "/fragment@0/__overlay__/qcom,cam-cpas/camera-bus-nodes/level3-nodes/level3-nrt0-rd-wr-sum/qcom,axi-port-mnoc:interconnects:0", "/fragment@0/__overlay__/qcom,cam-cpas/camera-bus-nodes/level3-nodes/level3-nrt1-rd-sum/qcom,axi-port-mnoc:interconnects:0";
		mc_virt = "/fragment@0/__overlay__/qcom,cam-cpas/camera-bus-nodes/level3-nodes/level3-rt0-wr-sum/qcom,axi-port-mnoc:interconnects:8", "/fragment@0/__overlay__/qcom,cam-cpas/camera-bus-nodes/level3-nodes/level3-nrt0-rd-wr-sum/qcom,axi-port-mnoc:interconnects:8", "/fragment@0/__overlay__/qcom,cam-cpas/camera-bus-nodes/level3-nodes/level3-nrt1-rd-sum/qcom,axi-port-mnoc:interconnects:8";
		qupv3_se0_i2c = "/fragment@1:target:0";
		qupv3_se3_i2c = "/fragment@2:target:0";
		qupv3_se4_i2c = "/fragment@3:target:0";
		pm8350c_l2 = "/fragment@3/__overlay__/qcom,ois@62:cam_vio-supply:0";
	};

	__local_fixups__ {

		fragment@0 {

			__overlay__ {

				qcom,camera-flash@0 {
					torch-source = <0x00>;
					flash-source = <0x00>;
				};

				qcom,cam-res-mgr {
					pinctrl-1 = <0x00>;
					pinctrl-0 = <0x00>;
				};

				qcom,cci0 {

					qcom,cam-sensor0 {
						pinctrl-1 = <0x00 0x08>;
						pinctrl-0 = <0x00 0x08>;
						cam_vaf-supply = <0x00>;
						cam_vana-supply = <0x00>;
						cam_vio-supply = <0x00>;
						cam_vdig-supply = <0x00>;
						led-flash-src = <0x00>;
						ois-src = <0x00>;
						eeprom-src = <0x00>;
						actuator-src = <0x00>;
					};
				};

				qcom,cci1 {

					qcom,actuator@0xC {
						cam_vaf-supply = <0x00>;
						cam_vio-supply = <0x00>;
					};

					qcom,eeprom@0x3F {
						pinctrl-1 = <0x00 0x08>;
						pinctrl-0 = <0x00 0x08>;
						cam_vio-supply = <0x00>;
						cam_vdig-supply = <0x00>;
					};

					qcom,eeprom@37 {
						pinctrl-1 = <0x00 0x08>;
						pinctrl-0 = <0x00 0x08>;
						cam_vdig-supply = <0x00>;
						cam_vio-supply = <0x00>;
					};

					qcom,eeprom@0x2D {
						pinctrl-1 = <0x00 0x08>;
						pinctrl-0 = <0x00 0x08>;
						cam_vio-supply = <0x00>;
					};

					qcom,eeprom@51 {
						cam_vio-supply = <0x00>;
					};

					qcom,eeprom@50 {
						cam_vio-supply = <0x00>;
						cam_vaf-supply = <0x00>;
					};

					qcom,cam-sensor4 {
						pinctrl-1 = <0x00 0x08 0x0c>;
						pinctrl-0 = <0x00 0x08 0x0c>;
						cam_vio-supply = <0x00>;
						cam_vdig-supply = <0x00>;
						eeprom-src = <0x00>;
						led-flash-src = <0x00>;
					};

					qcom,cam-sensor13 {
						pinctrl-1 = <0x00>;
						pinctrl-0 = <0x00>;
						cam_vana-supply = <0x00>;
						cam_vio-supply = <0x00>;
						cam_vdig-supply = <0x00>;
						eeprom-src = <0x00>;
					};

					qcom,cam-sensor1 {
						pinctrl-1 = <0x00>;
						pinctrl-0 = <0x00>;
						cam_vana-supply = <0x00>;
						cam_vio-supply = <0x00>;
						cam_vdig-supply = <0x00>;
						eeprom-src = <0x00>;
					};

					qcom,cam-sensor2 {
						pinctrl-1 = <0x00 0x08>;
						pinctrl-0 = <0x00 0x08>;
						cam_vio-supply = <0x00>;
						eeprom-src = <0x00>;
					};

					qcom,cam-sensor3 {
						pinctrl-1 = <0x00 0x08>;
						pinctrl-0 = <0x00 0x08>;
						cam_vio-supply = <0x00>;
						cam_vdig-supply = <0x00>;
						eeprom-src = <0x00>;
					};
				};

				qcom,cam_smmu {

					msm_cam_smmu_ife {
						memory-region = <0x00>;
					};

					msm_cam_smmu_jpeg {
						memory-region = <0x00>;
					};

					msm_cam_smmu_icp {
						memory-region = <0x00>;
					};

					msm_cam_smmu_cpas_cdm {
						memory-region = <0x00>;
					};

					msm_cam_smmu_lrme {
						memory-region = <0x00>;
					};
				};

				qcom,cam-cpas {

					camera-bus-nodes {

						level2-nodes {

							level2-rt0-write0 {
								parent-node = <0x00>;
							};

							level2-rt1-write0 {
								parent-node = <0x00>;
							};

							level2-nrt0-write0 {
								parent-node = <0x00>;
							};

							level2-nrt0-read0 {
								parent-node = <0x00>;
							};

							level2-nrt1-read0 {
								parent-node = <0x00>;
							};
						};

						level1-nodes {

							level1-rt0-write0 {
								parent-node = <0x00>;
							};

							level1-rt1-write0 {
								parent-node = <0x00>;
							};

							level1-rt1-write1 {
								parent-node = <0x00>;
							};

							level1-nrt0-write0 {
								parent-node = <0x00>;
							};

							level1-nrt0-read0 {
								parent-node = <0x00>;
							};

							level1-nrt1-write0 {
								parent-node = <0x00>;
							};

							level1-nrt1-read0 {
								parent-node = <0x00>;
							};
						};

						level0-nodes {

							ife0-rdi-wr {
								parent-node = <0x00>;
							};

							ife1-rdi-wr {
								parent-node = <0x00>;
							};

							ife2-rdi-wr {
								parent-node = <0x00>;
							};

							ife3-rdi-wr {
								parent-node = <0x00>;
							};

							ife4-rdi-wr {
								parent-node = <0x00>;
							};

							ife0-pixelall-wr {
								parent-node = <0x00>;
							};

							ife1-pixelall-wr {
								parent-node = <0x00>;
							};

							ife2-pixelall-wr {
								parent-node = <0x00>;
							};

							ipe0-ref-wr {
								parent-node = <0x00>;
							};

							bps0-all-wr {
								parent-node = <0x00>;
							};

							lrme0-all-wr {
								parent-node = <0x00>;
							};

							ipe0-viddisp-wr {
								parent-node = <0x00>;
							};

							ipe0-all-rd {
								parent-node = <0x00>;
							};

							bps0-all-rd {
								parent-node = <0x00>;
							};

							lrme0-all-rd {
								parent-node = <0x00>;
							};

							jpeg-enc0-all-wr {
								parent-node = <0x00>;
							};

							jpeg-enc0-all-rd {
								parent-node = <0x00>;
							};

							jpeg-dma0-all-wr {
								parent-node = <0x00>;
							};

							jpeg-dma0-all-rd {
								parent-node = <0x00>;
							};

							cpas-cdm0-all-rd {
								parent-node = <0x00>;
							};

							icp0-all-rd {
								parent-node = <0x00>;
							};
						};
					};
				};
			};
		};

		fragment@3 {

			__overlay__ {

				qcom,ois@62 {
					pinctrl-1 = <0x00>;
					pinctrl-0 = <0x00>;
					cam_vaf-supply = <0x00>;
				};
			};
		};

		fragment@4 {

			__overlay__ {

				cam_iommu_region_partition {
					iommu-addresses = <0x00 0x0c 0x18 0x24 0x30 0x3c 0x48 0x54 0x60 0x6c 0x78>;
				};
			};
		};
	};
};
