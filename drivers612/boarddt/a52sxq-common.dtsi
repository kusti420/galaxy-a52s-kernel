// SPDX-License-Identifier: GPL-2.0
/*
 * a52sxq board description for the Qualcomm 6.12 yupik base: common part (all hardware revisions)
 * GENERATED by tools/gen.py from the phone's stock dtbo (5.4 bindings, values verbatim).
 * Do not edit: hand-written 6.12 changes live in a52sxq-bsp612-fixups.dtsi.
 */

/* own subsystems (sec-platform first: it defines &samsung_mobile_device) */
/include/ "a52sxq-sec-platform.dtsi"
/include/ "a52sxq-memory.dtsi"
/include/ "a52sxq-pinctrl.dtsi"
/include/ "a52sxq-regulators.dtsi"
/include/ "a52sxq-pmic.dtsi"
/include/ "a52sxq-thermal.dtsi"
/include/ "a52sxq-buses.dtsi"
/include/ "a52sxq-storage.dtsi"
/include/ "a52sxq-usb.dtsi"
/include/ "a52sxq-sensors.dtsi"
/include/ "a52sxq-nfc.dtsi"
/include/ "a52sxq-input.dtsi"
/include/ "a52sxq-misc.dtsi"

/* subsystems owned by other drivers612 agents: see a52sxq-agents.dtsi (written by check-dt.sh) */
