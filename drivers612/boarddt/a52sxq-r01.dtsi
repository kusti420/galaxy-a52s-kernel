// SPDX-License-Identifier: GPL-2.0
/*
 * a52sxq board description for the Qualcomm 6.12 yupik base: what only hardware-revision entry r01 has
 * GENERATED by tools/gen.py from the phone's stock dtbo (5.4 bindings, values verbatim).
 * Do not edit: hand-written 6.12 changes live in a52sxq-bsp612-fixups.dtsi.
 */

&pmk8350_vadc {

	ap_therm {
		reg = <0x146>;
		label = "ap_therm";
		qcom,ratiometric;
		qcom,hw-settle-time = <0xc8>;
		qcom,pre-scaling = <0x1 0x1>;
		qcom,scale-fn-type = <0x5>;
	};

	pa_therm {
		reg = <0x148>;
		label = "pa_therm";
		qcom,ratiometric;
		qcom,hw-settle-time = <0xc8>;
		qcom,pre-scaling = <0x1 0x1>;
		qcom,scale-fn-type = <0x5>;
	};

	wf_therm {
		reg = <0x14c>;
		label = "wf_therm";
		qcom,ratiometric;
		qcom,hw-settle-time = <0xc8>;
		qcom,pre-scaling = <0x1 0x1>;
		qcom,scale-fn-type = <0x5>;
	};
};

