// SPDX-License-Identifier: GPL-2.0
/*
 * a52sxq board description for the Qualcomm 6.12 yupik base: sensors
 * GENERATED by tools/gen.py from the phone's stock dtbo (5.4 bindings, values verbatim).
 * Do not edit: hand-written 6.12 changes live in a52sxq-bsp612-fixups.dtsi.
 */

&soc {

	i2c_17: i2c@17 {
		status = "ok";
		cell-index = <0x11>;
		compatible = "i2c-gpio";
		gpios = <&tlmm 0x8 0x0 &tlmm 0x9 0x0>;
		i2c-gpio,delay-us = <0x2>;
		address-cells = <0x1>;
		size-cells = <0x0>;
		pinctrl-names = "default";
		pinctrl-0 = <&grip_i2c_active>;

		sx9360-i2c@28 {
			compatible = "sx9360";
			reg = <0x28>;
			pinctrl-names = "default";
			pinctrl-0 = <&grip_int_active>;
			interrupt-parent = <&tlmm>;
			interrupts = <0x7 0x0>;
			sx9360,nirq-gpio = <&tlmm 0x7 0x0>;
			sx9360,reggnrlctrl2_reg = <0x32>;
			sx9360,againfreq_reg = <0x38>;
			sx9360,refagainfreq_reg = <0x36>;
			sx9360,gainrawfilt_reg = <0x1a>;
			sx9360,refgainrawfilt_reg = <0x22>;
			sx9360,proxthresh_reg = <0x22>;
			sx9360,hyst_reg = <0x15>;
			sx9360,regproxctrl3_reg = <0xc>;
			sx9360,resolution_reg = <0xf>;
			sx9360,refresolution_reg = <0xf>;
			sx9360,vdd_en = <&tlmm 0x68 0x0>;
		};
	};
};

