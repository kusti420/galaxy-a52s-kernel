// SPDX-License-Identifier: GPL-2.0
/*
 * a52sxq board description for the Qualcomm 6.12 yupik base: storage
 * GENERATED by tools/gen.py from the phone's stock dtbo (5.4 bindings, values verbatim).
 * Do not edit: hand-written 6.12 changes live in a52sxq-bsp612-fixups.dtsi.
 */

&sdhc_1 {
	pinctrl-names = "default", "sleep";
	pinctrl-0 = <&sdc1_on>;
	pinctrl-1 = <&sdc1_off>;
	vdd-supply = <&L7B>;
	qcom,vdd-voltage-level = <0x2d0b40 0x2d0b40>;
	qcom,vdd-current-level = <0x0 0x8b290>;
	vdd-io-supply = <&L19B>;
	qcom,vdd-io-always-on;
	qcom,vdd-io-lpm-sup;
	qcom,vdd-io-voltage-level = <0x1b7740 0x1b7740>;
	qcom,vdd-io-current-level = <0x0 0x4f588>;
	status = "disabled";
};

&sdhc_2 {
	pinctrl-names = "default", "sleep";
	pinctrl-0 = <&sdc2_on>;
	pinctrl-1 = <&sdc2_off>;
	vdd-supply = <&L9C>;
	qcom,vdd-voltage-level = <0x2d2a80 0x2d2a80>;
	qcom,vdd-current-level = <0x0 0xc3500>;
	vdd-io-supply = <&L6C>;
	qcom,vdd-io-voltage-level = <0x1b7740 0x2d2a80>;
	qcom,vdd-io-current-level = <0x0 0x55f0>;
	cd-gpios = <&tlmm 0x5b 0x1>;
	status = "ok";
};

