// SPDX-License-Identifier: GPL-2.0
/*
 * a52sxq board description for the Qualcomm 6.12 yupik base: secure (owned by agent 'secure': TODO-binding placeholder)
 * GENERATED by tools/gen.py from the phone's stock dtbo (5.4 bindings, values verbatim).
 * Do not edit: hand-written 6.12 changes live in a52sxq-bsp612-fixups.dtsi.
 */

&soc {

	samsung,sec_hdm {
		memory-region = <&hdm_region>;
	};
};

