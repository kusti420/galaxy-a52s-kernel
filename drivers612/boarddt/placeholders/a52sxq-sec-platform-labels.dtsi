// SPDX-License-Identifier: GPL-2.0
/*
 * a52sxq board description for the Qualcomm 6.12 yupik base: placeholder labels for 'sec-platform'
 * GENERATED by tools/gen.py from the phone's stock dtbo (5.4 bindings, values verbatim).
 * Do not edit: hand-written 6.12 changes live in a52sxq-bsp612-fixups.dtsi.
 */

/*
 * Labels of the 5.4 base that the 6.12 base does not have. Placeholders under
 * /soc/a52sxq-todo-sec-platform (no compatible: nothing binds, children are not populated)
 * so that every reference of the phone's tree resolves. TODO-binding: replace by the
 * real 6.12 node of the owning driver and delete the placeholder.
 */
&soc {
	a52sxq_todo_sec_platform: a52sxq-todo-sec-platform {
		a52sxq,todo-binding;
		msm_imem: msm-imem {
			a52sxq,placeholder-for = "msm_imem";
		};
	};
};

