// SPDX-License-Identifier: GPL-2.0
/*
 * a52sxq board description for the Qualcomm 6.12 yupik base: nfc
 * GENERATED by tools/gen.py from the phone's stock dtbo (5.4 bindings, values verbatim).
 * Do not edit: hand-written 6.12 changes live in a52sxq-bsp612-fixups.dtsi.
 */

&qupv3_se9_i2c {

	nq@28 {
		compatible = "qcom,sn-nci";
		reg = <0x28>;
		qcom,sn-irq = <&tlmm 0x29 0x0>;
		qcom,sn-ven = <&tlmm 0x26 0x0>;
		qcom,sn-firm = <&tlmm 0x28 0x0>;
		qcom,sn-clkreq = <&tlmm 0x27 0x0>;
		qcom,sn-vdd-1p8-supply = <&L18B>;
		qcom,sn-vdd-1p8-voltage = <0x1b7740 0x1b7740>;
		qcom,sn-vdd-1p8-current = <0x26548>;
		interrupt-parent = <&tlmm>;
		interrupts = <0x29 0x0>;
		interrupt-names = "nfc_irq";
		pinctrl-names = "nfc_active", "nfc_suspend";
		pinctrl-0 = <&nfc_int_active &nfc_enable_active>;
		pinctrl-1 = <&nfc_int_suspend &nfc_enable_suspend>;
		status = "disabled";
	};

	sec-nfc@27 {
		compatible = "sec-nfc";
		reg = <0x27>;
		interrupt-parent = <&tlmm>;
		interrupts = <0x29 0x0>;
		sec-nfc,irq-gpio = <&tlmm 0x29 0x0>;
		sec-nfc,ven-gpio = <&tlmm 0x26 0x0>;
		sec-nfc,firm-gpio = <&tlmm 0x28 0x0>;
		sec-nfc,clk_req-gpio = <&tlmm 0x27 0x0>;
		sec-nfc,clk_req_wake;
		sec-nfc,ldo_control;
		nfc_pvdd-supply = <&fixed_regulator1>;
		sec-nfc,bootloader_ver = <0x6>;
		pinctrl-names = "default";
		pinctrl-0 = <&nfc_clk_req_gpio &nfc_irq_gpio &nfc_ven_gpio &nfc_firm_gpio>;
	};
};

